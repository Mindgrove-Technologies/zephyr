## CMakeLists.txt
```
cmake_minimum_required(VERSION 3.20.0)
find_package(Zephyr REQUIRED HINTS $ENV{ZEPHYR_BASE})
project(sha256_tests)

target_sources(app PRIVATE src/main.c)

if(CONFIG_SHA256_TEST_SINGLE_KAT)
    target_sources(app PRIVATE src/test_single_kat.c)
endif()

if(CONFIG_SHA256_TEST_MMT01)
    target_sources(app PRIVATE src/test_sha256_mmt_01.c)
endif()
if(CONFIG_SHA256_TEST_MMT02)
    target_sources(app PRIVATE src/test_sha256_mmt_02.c)
endif()
if(CONFIG_SHA256_TEST_MMT03)
    target_sources(app PRIVATE src/test_sha256_mmt_03.c)
endif()
if(CONFIG_SHA256_TEST_MMT04)
    target_sources(app PRIVATE src/test_sha256_mmt_04.c)
endif()
if(CONFIG_SHA256_TEST_MMT05)
    target_sources(app PRIVATE src/test_sha256_mmt_05.c)
endif()
if(CONFIG_SHA256_TEST_MMT06)
    target_sources(app PRIVATE src/test_sha256_mmt_06.c)
endif()

if(CONFIG_SHA256_TEST_MCT)
    target_sources(app PRIVATE src/test_mct.c)
endif()
```

## Kconfig
```
# Kconfig
mainmenu "SHA256 Test Application"

source "Kconfig.zephyr"

menu "SHA256 Test Selection"

config SHA256_TEST_SINGLE_KAT
    bool "Single-block KAT test"
    default n

config SHA256_TEST_MMT01
    bool "MMT vector 01"
    default n

config SHA256_TEST_MMT02
    bool "MMT vector 02"
    default n

config SHA256_TEST_MMT03
    bool "MMT vector 03"
    default n

config SHA256_TEST_MMT04
    bool "MMT vector 04"
    default n

config SHA256_TEST_MMT05
    bool "MMT vector 05"
    default n

config SHA256_TEST_MMT06
    bool "MMT vector 06"
    default n

config SHA256_TEST_MMT_ALL
    bool "All MMT vectors (01-06)"
    default n
    select SHA256_TEST_MMT01
    select SHA256_TEST_MMT02
    select SHA256_TEST_MMT03
    select SHA256_TEST_MMT04
    select SHA256_TEST_MMT05
    select SHA256_TEST_MMT06

config SHA256_TEST_MCT
    bool "Monte Carlo Test"
    default n

endmenu
```

## sample.yaml
```
sample:
  description: SHA sample
    application
  name: sha_256
common:
  tags: introduction
  integration_platforms:
    - native_posix
  harness: console
  harness_config:
    type: one_line
    regex:
      - "SHA256 SAMPLE"
tests:
  sample.basic.helloworld:
    tags: introduction
```

## prj.conf
```kconfig
# ---------------- Kernel ----------------
CONFIG_MULTITHREADING=y
# Standardize stack sizes
CONFIG_MAIN_STACK_SIZE=2048
CONFIG_IDLE_STACK_SIZE=256


# ---------------- Crypto ----------------
CONFIG_CRYPTO=y
CONFIG_CRYPTO_MINDGROVE_SHA256=y

# ---------------- Enabling Application ----------------
CONFIG_SHA256_TEST_SINGLE_KAT=y
CONFIG_SHA256_TEST_MMT01=n
CONFIG_SHA256_TEST_MMT02=n
CONFIG_SHA256_TEST_MMT03=n
CONFIG_SHA256_TEST_MMT04=n
CONFIG_SHA256_TEST_MMT05=n
CONFIG_SHA256_TEST_MMT06=n

CONFIG_SHA256_TEST_MCT=y
# ---------------- UART / printk ---------
CONFIG_SERIAL=y
CONFIG_UART_MINDGROVE=y
CONFIG_CONSOLE=y
CONFIG_UART_CONSOLE=y
CONFIG_PRINTK=y

# ---------------- Memory ----------------
CONFIG_HEAP_MEM_POOL_SIZE=0

# ---------------- Disable bloat ---------
CONFIG_LOG=n
CONFIG_ASSERT=n
CONFIG_DEBUG=n
CONFIG_POSIX_API=n
CONFIG_TIMING_FUNCTIONS=n
CONFIG_HEAP_MEM_POOL_SIZE=2048

# # ---------------- Libc ------------------
# CONFIG_MINIMAL_LIBC=y
# CONFIG_NEWLIB_LIBC=n
CONFIG_MINIMAL_LIBC_RAND=y

# ---------------- Size ------------------
CONFIG_SIZE_OPTIMIZATIONS=y
```

## src/main.c
```c
#include <zephyr/kernel.h>
#include <zephyr/sys/printk.h>
#include <autoconf.h>

#if defined(CONFIG_SHA256_TEST_SINGLE_KAT)
int test_sha256_single_block_kat(void);
#endif

#if defined(CONFIG_SHA256_TEST_MMT01)
int test_sha256_mmt_01(void);
#endif
#if defined(CONFIG_SHA256_TEST_MMT02)
int test_sha256_mmt_02(void);
#endif
#if defined(CONFIG_SHA256_TEST_MMT03)
int test_sha256_mmt_03(void);
#endif
#if defined(CONFIG_SHA256_TEST_MMT04)
int test_sha256_mmt_04(void);
#endif
#if defined(CONFIG_SHA256_TEST_MMT05)
int test_sha256_mmt_05(void);
#endif
#if defined(CONFIG_SHA256_TEST_MMT06)
int test_sha256_mmt_06(void);
#endif

#if defined(CONFIG_SHA256_TEST_MCT)
int test_sha_monte_carlo(void);
#endif

int main(void)
{
    printk("\n===== Mindgrove SHA256 Tests =====\n");

#if defined(CONFIG_SHA256_TEST_SINGLE_KAT)
    printk(test_sha256_single_block_kat() ? "SINGLE KAT: FAILED\n" : "SINGLE KAT: PASSED\n");
#endif

#if defined(CONFIG_SHA256_TEST_MMT01)
    printk(test_sha256_mmt_01() ? "MMT01: FAILED\n" : "MMT01: PASSED\n");
#endif
#if defined(CONFIG_SHA256_TEST_MMT02)
    printk(test_sha256_mmt_02() ? "MMT02: FAILED\n" : "MMT02: PASSED\n");
#endif
#if defined(CONFIG_SHA256_TEST_MMT03)
    printk(test_sha256_mmt_03() ? "MMT03: FAILED\n" : "MMT03: PASSED\n");
#endif
#if defined(CONFIG_SHA256_TEST_MMT04)
    printk(test_sha256_mmt_04() ? "MMT04: FAILED\n" : "MMT04: PASSED\n");
#endif
#if defined(CONFIG_SHA256_TEST_MMT05)
    printk(test_sha256_mmt_05() ? "MMT05: FAILED\n" : "MMT05: PASSED\n");
#endif
#if defined(CONFIG_SHA256_TEST_MMT06)
    printk(test_sha256_mmt_06() ? "MMT06: FAILED\n" : "MMT06: PASSED\n");
#endif

#if defined(CONFIG_SHA256_TEST_MCT)
    printk(test_sha_monte_carlo() ? "MCT: FAILED\n" : "MCT: PASSED\n");
#endif

    printk("\n===== SHA256 Tests Complete =====\n");
    return 0;
}
```

## src/sha256_test.h
```c
#ifndef SHA256_TEST_H
#define SHA256_TEST_H

#include <zephyr/kernel.h>
#include <zephyr/device.h>
#include <zephyr/crypto/crypto.h>
#include <zephyr/crypto/hash.h>
#include <zephyr/sys/printk.h>

#include <string.h>
#include <stdbool.h>

#include "rsp_files.h"

#define SHA256_HASH_LEN 32
#define SHA256_DIGEST_SIZE 32

void print_digest(const uint8_t *digest);

/* Single block KAT */
int test_sha256_single_block_kat(void);

/* Multi block tests */
int test_sha256_mmt_01(void);
int test_sha256_mmt_02(void);
int test_sha256_mmt_03(void);
int test_sha256_mmt_04(void);
int test_sha256_mmt_05(void);
int test_sha256_mmt_06(void);

/* Monte */
// int test_sha_monte_carlo(void);

#endif
```

## src/test_helpers.h
```c
#ifndef TEST_HELPERS_H
#define TEST_HELPERS_H

#include <stdint.h>
#include <stddef.h>

#define SHA256_HASH_LEN     32
#define SHA256_DIGEST_SIZE  32

static inline void print_hex(const char *label, const uint8_t *data, size_t len)
{
    printk("%s: ", label);
    for (size_t i = 0; i < len; i++) {
        printk("%02x", data[i]);
        if ((i + 1) % 32 == 0 && i + 1 < len) printk("\n          ");
    }
    printk("\n");
}

static inline void print_digest(const uint8_t *digest)
{
    for (int i = 0; i < SHA256_DIGEST_SIZE; i++) {
        printk("%02x", digest[i]);
    }
}

#endif /* TEST_HELPERS_H */
```

## src/test_mct.c
```c
#include <zephyr/kernel.h>
#include <zephyr/crypto/crypto.h>
#include <zephyr/crypto/hash.h>
#include <zephyr/sys/printk.h>
#include <string.h>
#include "test_helpers.h"

/* Monte Carlo test using proper streaming API */
int test_sha_monte_carlo(void)
{
    const struct device *dev = DEVICE_DT_GET_ONE(mindgrove_sha256);
    
    if (!device_is_ready(dev)) {
        printk("SHA device not ready\n");
        return -ENODEV;
    }

    uint8_t Seed[SHA256_DIGEST_SIZE] = {
        0x6d, 0x1e, 0x72, 0xad, 0x03, 0xdd, 0xeb, 0x5d,
        0xe8, 0x91, 0xe5, 0x72, 0xe2, 0x39, 0x6f, 0x8d,
        0xa0, 0x15, 0xd8, 0x99, 0xef, 0x0e, 0x79, 0x50,
        0x31, 0x52, 0xd6, 0x01, 0x0a, 0x3f, 0xe6, 0x91};

    uint8_t MD0[SHA256_DIGEST_SIZE];
    uint8_t MD1[SHA256_DIGEST_SIZE];
    uint8_t MD2[SHA256_DIGEST_SIZE];
    uint8_t MDnew[SHA256_DIGEST_SIZE];
    
    /* Buffer for Mi = MD[i-3] || MD[i-2] || MD[i-1] */
    uint8_t Mi[3 * SHA256_DIGEST_SIZE]; // 96 bytes
    
    struct hash_ctx ctx;
    struct hash_pkt pkt;
    int ret;
    
    printk("Starting SHA256 Monte Carlo test...\n");

    /*------------------------------------------------------------
     * Perform 100 outer iterations
     *------------------------------------------------------------*/
    for (int j = 0; j < 100; j++) {
        /* Initialize MD0, MD1, MD2 = Seed */
        memcpy(MD0, Seed, SHA256_DIGEST_SIZE);
        memcpy(MD1, Seed, SHA256_DIGEST_SIZE);
        memcpy(MD2, Seed, SHA256_DIGEST_SIZE);

        /*--------------------------------------------------------
         * Perform 1000 rounds
         *--------------------------------------------------------*/
        for (int i = 3; i < 1003; i++) {
            /* Mi = MD[i-3] || MD[i-2] || MD[i-1] */
            memcpy(Mi, MD0, SHA256_DIGEST_SIZE);
            memcpy(Mi + SHA256_DIGEST_SIZE, MD1, SHA256_DIGEST_SIZE);
            memcpy(Mi + 2 * SHA256_DIGEST_SIZE, MD2, SHA256_DIGEST_SIZE);

            /* ============================================
             * KEY FIX: Use hash_update() + hash_final()
             * instead of single hash_hndlr() call
             * ============================================ */
            
            /* Begin a NEW session for each independent SHA256 operation */
            ret = hash_begin_session(dev, &ctx, CRYPTO_HASH_ALGO_SHA256);
            if (ret != 0) {
                printk("Failed to begin session at i=%d: %d\n", i, ret);
                return ret;
            }

            /* STEP 1: hash_update() for first 512 bits (64 bytes) */
            memset(&pkt, 0, sizeof(pkt));
            pkt.in_buf = Mi;
            pkt.in_len = 64;  // 512 bits = 64 bytes
            ret = hash_update(&ctx, &pkt);
            if (ret != 0) {
                printk("hash_update failed at j=%d, i=%d: %d\n", j, i, ret);
                hash_free_session(dev, &ctx);
                return ret;
            }

            /* STEP 2: hash_final() for remaining 256 bits (32 bytes) */
            memset(&pkt, 0, sizeof(pkt));
            pkt.in_buf = Mi + 64;  // Remaining 32 bytes
            pkt.in_len = 32;       // 256 bits = 32 bytes
            pkt.out_buf = MDnew;
            ret = hash_compute(&ctx, &pkt);
            if (ret != 0) {
                printk("hash_final failed at j=%d, i=%d: %d\n", j, i, ret);
                hash_free_session(dev, &ctx);
                return ret;
            }

            /* Free session - each SHA256(Mi) is independent */
            hash_free_session(dev, &ctx);

            /* Shift the MD buffers */
            memcpy(MD0, MD1, SHA256_DIGEST_SIZE);
            memcpy(MD1, MD2, SHA256_DIGEST_SIZE);
            memcpy(MD2, MDnew, SHA256_DIGEST_SIZE);
        }

        /* End of 1000 rounds: Seed = MD1002 (MD2) */
        memcpy(Seed, MD2, SHA256_DIGEST_SIZE);

        /* Print checkpoint */
        printk("COUNT = %d\n", j);
        printk("MD = ");
        print_digest(MD2);
        printk("\n");

    }
    // NIST Expected Result for Outer Loop 0
    uint8_t expected_0[32] = {
        0x6a, 0x91, 0x2b, 0xa4, 0x18, 0x83, 0x91, 0xa7,
        0x8e, 0x6f, 0x13, 0xd8, 0x8e, 0xd2, 0xd1, 0x4e,
        0x13, 0xaf, 0xce, 0x9d, 0xb6, 0xf7, 0xdc, 0xbf,
        0x4a, 0x48, 0xc2, 0x4f, 0x3d, 0xb0, 0x27, 0x78
    };
    if (memcmp(MD2, expected_0, 32) == 0) {
        printk(" -> [PASS] MATCHES NIST GROUND TRUTH\n");
        return 0;
    } else {
        printk(" -> [FAIL] DOES NOT MATCH NIST\n");
        return EFAULT;
    }
}
```

## src/test_mmt.h
```c
#ifndef TEST_MMT_H
#define TEST_MMT_H

/* One function per MMT file. Only declared here;
 * the linker will only see the ones that were compiled in. */

int test_sha256_mmt_01(void);
int test_sha256_mmt_02(void);
int test_sha256_mmt_03(void);
int test_sha256_mmt_04(void);
int test_sha256_mmt_05(void);
int test_sha256_mmt_06(void);

#endif /* TEST_MMT_H */
```

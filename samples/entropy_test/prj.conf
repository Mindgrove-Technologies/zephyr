## CMakeLists.txt
```
# SPDX-License-Identifier: Apache-2.0

cmake_minimum_required(VERSION 3.20.0)

find_package(Zephyr REQUIRED HINTS $ENV{ZEPHYR_BASE})
project(entropy_test)

target_sources(app PRIVATE src/main.c)

if(CONFIG_XIP)
    zephyr_code_relocate(FILES src/main.c LOCATION ROM_TEXT NOCOPY)
    zephyr_code_relocate(FILES src/main.c LOCATION RAM_DATA)
    zephyr_code_relocate(FILES src/main.c LOCATION RAM_BSS)
endif()
```

## sample.yaml
```
sample:
  description: TRNG sample, the simplest Zephyr
    application
  name: entropy_test
common:
  min_ram: 2
  min_flash: 16
  tags: introduction
  integration_platforms:
    - native_sim
  harness: console
  harness_config:
    type: one_line
    regex:
      - "entropy_test! (.*)"
```

## prj.conf
```kconfig
CONFIG_UART_MINDGROVE=y
CONFIG_UART_CONSOLE=y
CONFIG_MULTITHREADING=y
CONFIG_PRINTK=y
CONFIG_ENTROPY_MINDGROVE=y
CONFIG_ENTROPY_GENERATOR=y
```

## src/main.c
```c
#include <zephyr/kernel.h>
#include <zephyr/device.h>
#include <zephyr/drivers/entropy.h>
#include <zephyr/sys/printk.h>

#define SAMPLES_TO_COLLECT 10
#define BUFFER_SIZE 16

int main(void)
{
    /* 1. Get the device binding from the 'chosen' node */
    const struct device *const entropy_dev = DEVICE_DT_GET(DT_CHOSEN(zephyr_entropy));
    uint8_t entropy_buffer[BUFFER_SIZE];
    int ret;

    printk("\n\r--- Mindgrove TRNG Hardware Test ---\n\r");

    /* 2. Check if the driver initialized successfully */
    if (!device_is_ready(entropy_dev)) {
        printk("Error: TRNG device not ready. Check your init priority!\n\r");
        return -EIO;
    }

    printk("Device %s is ready. Starting data collection...\n\r", entropy_dev->name);

    for (int s = 1; s <= SAMPLES_TO_COLLECT; s++) {
        /* 3. Call the standard API */
        ret = entropy_get_entropy(entropy_dev, entropy_buffer, BUFFER_SIZE);

        if (ret < 0) {
            printk("Sample %d: Failed to get entropy (Error: %d)\n\r", s, ret);
        } else {
            printk("Sample %02d [%db]: ", s, BUFFER_SIZE);
            for (int i = 0; i < BUFFER_SIZE; i++) {
                printk("%02x ", entropy_buffer[i]);
            }
            printk("\n\r");
        }

    }

    return 0;
}
```

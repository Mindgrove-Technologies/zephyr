## CMakeLists.txt
```
#
# Copyright (c) 2025 Mindgrove Technologies
#

cmake_minimum_required(VERSION 3.20.0)

find_package(Zephyr REQUIRED HINTS $ENV{ZEPHYR_BASE})
project(coremark)

# Your application’s own main() and portme
target_sources(app PRIVATE
  src/main.c
)
```

## prj.conf
```kconfig
#
# Copyright (c) 2025 Mindgrove Technologies
#

# Common coremark configuration
############################################################################

CONFIG_COREMARK=y

# Uncomment the below for debugging the coremarks code.
# CONFIG_COREMARK_DEBUG=y

# Uncomment the below set for running the coremarks on POSIX PThreads.
CONFIG_COREMARK_PTHREADS=y
CONFIG_POSIX_AEP_CHOICE_BASE=y
CONFIG_POSIX_API=y
CONFIG_DYNAMIC_THREAD_POOL_SIZE=6
CONFIG_MAX_PTHREAD_MUTEX_COUNT=6
CONFIG_NUM_COOP_PRIORITIES=4
CONFIG_NUM_PREEMPT_PRIORITIES=8
CONFIG_POSIX_THREAD_THREADS_MAX=8
CONFIG_MAX_PTHREAD_SPINLOCK_COUNT=4

# Uncomment the below set for running the coremarks on Zephyr KThreads.
# CONFIG_COREMARK_ZTHREADS=y

# Uncomment the below set for running the coremarks on Stack Memory.
# CONFIG_COREMARK_MEMORY_METHOD_STACK=y

# Uncomment the below set for running the coremarks on Heap Memory.
CONFIG_COREMARK_MEMORY_METHOD_MALLOC=y
CONFIG_HEAP_MEM_POOL_SIZE=8192

# Uncomment the below set for running the coremarks on Static Memory.
# CONFIG_COREMARK_MEMORY_METHOD_STATIC=y

# Uncomment one of the below set for running the coremarks for Mode Performance/Profile/Validation.
CONFIG_COREMARK_RUN_TYPE_PERFORMANCE=y
# CONFIG_COREMARK_RUN_TYPE_PROFILE=y
# CONFIG_COREMARK_RUN_TYPE_VALIDATION=y

# Configure below to run on SMP or Single Threaded.
CONFIG_SMP=y
CONFIG_MP_MAX_NUM_CPUS=4
CONFIG_COREMARK_THREADS_NUMBER=4

# Set Coremarks Threads Priority
CONFIG_COREMARK_THREADS_PRIORITY=5

# Set number of iterations for coremarks to run.
CONFIG_COREMARK_ITERATIONS=1

# Add compiler options that are not included by default in Zephyr.
CONFIG_COMPILER_OPT="-O2 -fno-common -funroll-loops -finline-functions -fselective-scheduling -falign-functions=4 -falign-jumps=4 -falign-loops=4 -finline-limit=1000 -ffast-math -mexplicit-relocs -ffreestanding "

# CONFIG_COMPILER_OPT="-O2"

# Increse if number of threads increases.
CONFIG_MAIN_STACK_SIZE=8192
CONFIG_ISR_STACK_SIZE=4096
CONFIG_IDLE_STACK_SIZE=4096
CONFIG_SYSTEM_WORKQUEUE_STACK_SIZE=4096

# Below as MISC.
CONFIG_UART_INTERRUPT_DRIVEN=y
CONFIG_EXCEPTION_DEBUG=y
CONFIG_TICKET_SPINLOCKS=y
# CONFIG_TIMESLICING=y
# CONFIG_TIMESLICE_SIZE=5 
# CONFIG_TIMESLICE_PRIORITY=0
CONFIG_DYNAMIC_THREAD=y
CONFIG_THREAD_STACK_INFO=y
CONFIG_KERNEL_MEM_POOL=y
CONFIG_THREAD_RUNTIME_STATS=n


# CONFIG_DEBUG_COREDUMP=y
# CONFIG_DEBUG_COREDUMP_MEMORY_DUMP_THREADS=y
# CONFIG_DEBUG_COREDUMP_MEMORY_DUMP_LINKER_RAM=y
```

## src/main.c
```c
/*
 * Copyright (c) 2025 Mindgrove Technologies
 */

/*
 * Main function implementation
 */
#include <zephyr/init.h>
#include <zephyr/kernel.h>
#include <zephyr/logging/log.h>

LOG_MODULE_REGISTER(app, LOG_LEVEL_INF);

#define COOP_PRIO -1

static K_SEM_DEFINE(start_coremark, 0, 1);
static atomic_t coremark_in_progress;

static void main_thread_priority_cooperative_set(void)
{
    BUILD_ASSERT(CONFIG_MAIN_THREAD_PRIORITY >= 0);
    k_thread_priority_set(k_current_get(), COOP_PRIO);
}

int main(void)
{
    /* Drivers need to be run from a non-blocking thread.
     * We need preemptive priority during init.
     * Later we prefer cooperative priority to ensure no interference with the benchmark.
     */
    main_thread_priority_cooperative_set();

    printk("CoreMark sample for %s\n\r", CONFIG_BOARD_TARGET);

#if defined(CONFIG_COREMARK_PTHREADS)
    printk("Threading: POSIX pthreads\n\r");
#elif defined(CONFIG_COREMARK_ZTHREADS)
    printk("Threading: Zephyr k_threads\n\r");
#else
    printk("Threading: Single-threaded\n\r");
#endif

    (void)atomic_set(&coremark_in_progress, true);
    k_sem_give(&start_coremark);
    
    while (true) {
        k_sem_take(&start_coremark, K_FOREVER);

        printk("CoreMark started!\n\r");
        printk("Threads: %d\n\r", CONFIG_COREMARK_THREADS_NUMBER);  
        printk("Iterations Per-Core: %d\n\r", CONFIG_COREMARK_ITERATIONS);

        long unsigned total_ticks = coremark_run();
	    
        __asm__ volatile (
		      "li a0, %0\n\t"
		      "csrs mstatus, a0\n\t"
		      "csrwi fcsr, 0\n\t"
		      : // no outputs
		      : "i" (MSTATUS_FS & (MSTATUS_FS >> 1))
		      : "a0", "memory"
		  );
       
        float coremarks_per_mhz = ((CONFIG_COREMARK_THREADS_NUMBER*CONFIG_COREMARK_ITERATIONS*1000000)/total_ticks);

		printk("CoreMark/MHz is %.4f\n\r", coremarks_per_mhz);

        printk("CoreMark finished!\n\r");

        (void)atomic_set(&coremark_in_progress, false);
    };

    return 0;
}
```

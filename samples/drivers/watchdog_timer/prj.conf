## prj.conf
```kconfig
CONFIG_LOG=y
CONFIG_LOG_MODE_IMMEDIATE=y
CONFIG_WDT_LOG_LEVEL_DBG=y
CONFIG_WATCHDOG=y
CONFIG_WDT_DISABLE_AT_BOOT=n
CONFIG_WDT_MINDGROVE=y
CONFIG_MULTITHREADING=y
```

## src/main.c
```c
#include <stdio.h>

#include <zephyr/kernel.h>
#include <zephyr/device.h>
#include <zephyr/drivers/watchdog.h>
#include <zephyr/sys/printk.h>
#include <stdbool.h>

int main()
{
	// const struct device *wdt = DEVICE_DT_GET(DT_ALIAS(watchdog));
    int tr;
    printk("Hello \n");
    k_busy_wait(100);   
    const struct device *dev = DEVICE_DT_GET(DT_NODELABEL(watchdog0));
    // tr = wdt_disable(dev);
    struct wdt_timeout_cfg cfg = {
    .window.min = 0,
    .window.max = 1000, // ms
    
    };

    wdt_install_timeout(dev,&cfg);
    wdt_setup(dev,3);
    return 0;
}
```

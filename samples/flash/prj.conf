## CMakeLists.txt
```
# SPDX-License-Identifier: Apache-2.0

cmake_minimum_required(VERSION 3.20.0)

find_package(Zephyr REQUIRED HINTS $ENV{ZEPHYR_BASE})
project(flash)

target_sources(app PRIVATE src/main.c)

if(CONFIG_XIP)
    zephyr_code_relocate(FILES src/main.c LOCATION ROM_TEXT NOCOPY)
    zephyr_code_relocate(FILES src/main.c LOCATION ROM_DATA)
    zephyr_code_relocate(FILES src/main.c LOCATION ROM_BSS)
endif()
```

## sample.yaml
```
sample:
  description: Flash read, write, erase
  name: flash
common:
  tags: introduction
  integration_platforms:
    - native_posix
  harness: console
  harness_config:
    type: one_line
    regex:
      - "Flash (.*)"
tests:
  sample.basic.flash:
    tags: introduction
```

## prj.conf
```kconfig
CONFIG_I2C_SECURE_IOT=y
CONFIG_MULTITHREADING=y

# CONFIG_LOG=y
# CONFIG_ILI9341=y
# # CONFIG_TFT=y
# CONFIG_DISPLAY_LOG_LEVEL_ERR=y
# CONFIG_SPI=y
# CONFIG_SPI_SHAKTI=y
# CONFIG_TFT=y


CONFIG_LV_Z_MEM_POOL_SIZE=16384
CONFIG_MAIN_STACK_SIZE=2048

# CONFIG_ILI9341=y
# CONFIG_TFT=y
CONFIG_DISPLAY=y
CONFIG_DISPLAY_LOG_LEVEL_ERR=y
CONFIG_SPI=y
CONFIG_SPI_SHAKTI=y
CONFIG_LOG=y
CONFIG_MULTITHREADING=y
CONFIG_LVGL=y
CONFIG_LV_MEM_CUSTOM=y
CONFIG_LV_USE_LOG=y
CONFIG_LV_USE_LABEL=y
CONFIG_LV_USE_BTN=y
CONFIG_LV_USE_IMG=y
CONFIG_LV_FONT_MONTSERRAT_14=y

CONFIG_GPIO=y
CONFIG_SERIAL=y

CONFIG_FLASH=y
CONFIG_SECUREIOT_FLASH=y
```

## src/main.c
```c
#include <zephyr/kernel.h>
#include <zephyr/device.h>
#include <zephyr/devicetree.h>
#include <stdio.h>
#include <string.h>
#include <zephyr/drivers/flash.h>

int main()
{
	const struct device *const flash_dev = DEVICE_DT_GET(DT_NODELABEL(qspi0));
	off_t offset = 0x200;
	size_t size = 16;
	uint8_t write_data[16];
	uint8_t read_data[16];
	int ret;

	for (int i = 0; i < size; i++) {
        write_data[i] = i;
    }

	if (!device_is_ready(flash_dev)) {
		printk("Flash device not ready!\n");
		return 1;
    }

// Erase the flash region
    ret = flash_erase(flash_dev, offset, size);
    if (ret != 0) {
        printk("Flash erase failed! (err %d)\n", ret);
        return 1;
    }

    // Write data to flash
    ret = flash_write(flash_dev, offset, write_data, size);
    if (ret != 0) {
        printk("Flash write failed! (err %d)\n", ret);
        return 1;
    }

    // Read data back from flash
    ret = flash_read(flash_dev, offset, read_data, size);
    if (ret != 0) {
        printk("Flash read failed! (err %d)\n", ret);
        return 1;
    }

    // Verify data
    for (int i = 0; i < size; i++) {
        if (read_data[i] != write_data[i]) {
            printk("Data mismatch at offset %d: wrote 0x%02x, read 0x%02x\n", i, write_data[i], read_data[i]);
            return 1;
        }
    }

    printk("Flash erase, write, and read successful!\n");
}
```

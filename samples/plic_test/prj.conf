## CMakeLists.txt
```
# SPDX-License-Identifier: Apache-2.0

cmake_minimum_required(VERSION 3.20.0)

find_package(Zephyr REQUIRED HINTS $ENV{ZEPHYR_BASE})
project(plic_test)

target_sources(app PRIVATE src/main.c)

if(CONFIG_XIP)
    zephyr_code_relocate(FILES src/main.c LOCATION ROM_TEXT NOCOPY)
    zephyr_code_relocate(FILES src/main.c LOCATION RAM_DATA)
    zephyr_code_relocate(FILES src/main.c LOCATION RAM_BSS)
endif()
```

## Kconfig
```
config HAS_MMIO
    bool
    default y

config MMIO_HELPERS
    bool
    default y
    depends on HAS_MMIO

source "Kconfig.zephyr"
```

## prj.conf
```kconfig
# Core
CONFIG_MULTITHREADING=y
CONFIG_MAIN_STACK_SIZE=4096

# Console / UART
CONFIG_SERIAL=y
CONFIG_UART_MINDGROVE=y
CONFIG_UART_CONSOLE=y
CONFIG_STDOUT_CONSOLE=y
CONFIG_EARLY_CONSOLE=y
CONFIG_PRINTK=y

# GPIO
CONFIG_GPIO=y
CONFIG_GPIO_LOG_LEVEL_DBG=y

# Interrupt controller
CONFIG_PLIC=y
CONFIG_MULTI_LEVEL_INTERRUPTS=y
CONFIG_2ND_LEVEL_INTERRUPTS=y
CONFIG_NUM_2ND_LEVEL_AGGREGATORS=1
CONFIG_INTC_SINGLE_AGGREGATOR=y
CONFIG_INTC_INIT_PRIORITY=40
CONFIG_PLIC_MEIP_PRIORITY=1

# IRQ layout — matches working DMA config exactly
# PLIC source N → flat IRQ = 41 + N
# GPIO pin 0 = PLIC source 1 → flat IRQ 42
CONFIG_2ND_LVL_INTR_00_OFFSET=11
CONFIG_MAX_IRQ_PER_AGGREGATOR=82
CONFIG_NUM_IRQS=123

# ISR tables
CONFIG_GEN_ISR_TABLES=y
CONFIG_GEN_SW_ISR_TABLE=y
CONFIG_GEN_IRQ_VECTOR_TABLE=y
CONFIG_IRQ_VECTOR_TABLE_JUMP_BY_CODE=y
CONFIG_DYNAMIC_INTERRUPTS=y

# Logging
CONFIG_LOG=y
CONFIG_LOG_DEFAULT_LEVEL=3
```

## src/main.c
```c
#include <zephyr/kernel.h>
#include <zephyr/device.h>
#include <zephyr/devicetree.h>
#include <zephyr/drivers/gpio.h>
#include <zephyr/sys/sys_io.h>
#include <zephyr/logging/log.h>
#include <zephyr/drivers/interrupt_controller/riscv_plic.h>

LOG_MODULE_REGISTER(gpio_test, LOG_LEVEL_INF);

#define GPIO_NODE  DT_NODELABEL(gpio0)
#define TEST_PIN   0

/* PLIC / GPIO register addresses */
#define PLIC_PEND  0x0C001000U
#define PLIC_EN    0x0C002000U
#define PLIC_CLAIM 0x0C200004U
#define GPIO_INTR  0x40230U
#define GPIO_DATA  0x40208U

static struct gpio_callback gpio_cb;
static volatile uint32_t isr_count;

static void gpio_interrupt_cb(const struct device *dev,
                              struct gpio_callback *cb, uint32_t pins)
{
    isr_count++;

    /* Complete PLIC claim first */
    uint32_t claim = sys_read32(PLIC_CLAIM);
    if (claim != 0) {
        sys_write32(claim, PLIC_CLAIM);
        __asm__ volatile("fence iorw, iorw" ::: "memory");
    }

    /* Re-enable PLIC source if needed */
    riscv_plic_irq_enable(13);

}

int main(void)
{
    const struct device *gpio_dev = DEVICE_DT_GET(GPIO_NODE);
    uint32_t last_count = 0;

    printk("=== Mindgrove GPIO interrupt auto-rearm test ===\n");
    printk("TEST_PIN=%d\n", TEST_PIN);

    if (!device_is_ready(gpio_dev)) {
        printk("ERROR: GPIO device not ready\n");
        return 0;
    }

    printk("[MAIN] GPIO device ready\n");

    /* Configure pin as input with pull-up */
    gpio_pin_configure(gpio_dev, TEST_PIN, GPIO_INPUT | GPIO_PULL_UP);

    /* Register ISR */
    gpio_init_callback(&gpio_cb, gpio_interrupt_cb, BIT(TEST_PIN));
    gpio_add_callback(gpio_dev, &gpio_cb);

    /* Configure GPIO interrupt (level-low) */
   gpio_pin_interrupt_configure(gpio_dev, TEST_PIN,
                             GPIO_INT_LEVEL_LOW);

    /* Enable PLIC source */
    riscv_plic_irq_enable(13);

    printk("[MAIN] interrupt configured. Monitoring pin...\n");

    /* --- Polling loop: only print on new ISR events --- */
    while (1) {
        if (isr_count != last_count) {
            printk("[EVENT] New ISR triggered! ISR_count=%u, pin_val=%d\n",
                   isr_count, gpio_pin_get_raw(gpio_dev, TEST_PIN));
            last_count = isr_count;
        }

        k_sleep(K_MSEC(100));  /* check every 100ms */
    }

    return 0;
}
```

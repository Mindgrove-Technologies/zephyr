## CMakeLists.txt
```
# SPDX-License-Identifier: Apache-2.0

cmake_minimum_required(VERSION 3.20.0)

find_package(Zephyr REQUIRED HINTS $ENV{ZEPHYR_BASE})
project(flash_qspi)

target_sources(app PRIVATE src/main.c)

set(OPENOCD_EXECUTABLE "/usr/local/bin/mind-openocd")

# if(CONFIG_XIP)
#     zephyr_code_relocate(src/main.c TEXT NOCOPY)
#     zephyr_code_relocate(src/main.c ROM)
#     zephyr_code_relocate(src/main.c ROM_BSS)
# endif()
```

## sample.yaml
```
sample:
  description: Hello World sample, the simplest Zephyr
    application
  name: flash_qspi
common:
  tags: introduction
  integration_platforms:
    - native_posix
  harness: console
  harness_config:
    type: one_line
    regex:
      - "flash qspi! (.*)"
tests:
  sample.basic.flashqspi:
    tags: introduction
```

## prj.conf
```kconfig
CONFIG_CODE_DATA_RELOCATION=n
CONFIG_HAVE_CUSTOM_LINKER_SCRIPT=y
CONFIG_CUSTOM_LINKER_SCRIPT="linker_secure-iot.ld"
CONFIG_XIP=y
CONFIG_FLASH=y
CONFIG_FLASH_BASE_ADDRESS=0x80000000
CONFIG_FLASH_SHAKTI=y
CONFIG_BOARD_SECURE_IOT=y
```

## src/main.c
```c
/*
 * Copyright (c) 2012-2014 Wind River Systems, Inc.
 *
 * SPDX-License-Identifier: Apache-2.0
 */

#include <stdio.h>
#include <string.h>
#include <zephyr/kernel.h>
#include <zephyr/drivers/flash.h>
#include <zephyr/device.h>
#include <zephyr/devicetree.h>

#define SectorErase_addr 0x00000000
#define FLASH_4K_ERASE             4096
#define FLASH_32K_ERASE            32768
#define FLASH_CHIP_ERASE           134217728    

int main(void)
{
	const struct device *const dev = DEVICE_DT_GET(DT_NODELABEL(qspi0));
	printf("Hello World! %s\n", CONFIG_BOARD);

	const uint8_t expected[] = { 0x55, 0xaa, 0x66, 0x99 };
	const size_t len = sizeof(expected);
	uint8_t buf[sizeof(expected)];
	int rc;

	/*
	printk("\nTest 1: Flash erase\n");
	
	rc = flash_erase(dev, SectorErase_addr, FLASH_32K_ERASE);
	if(rc != 0) {
		printk("Flash erase failed %d\n", rc);
	} else {
		printk("Flash erase succeeded!\n");
	}

	printk("\n Test 2: Flash write\n");
	rc = flash_write(dev, 0x00000400, expected, len);
	if (rc == 0) {
		printf("Flash write successfull! %d\n", rc);
		// return;
	}

	printk("\n Test 3: Flash read\n");
	rc = flash_read(dev, 0x00000400, buf, len);
	if (rc == 0) {
		printf("Flash read successfull! %d\n", rc);
		// return;
	}
	*/

	return 0;
}
```

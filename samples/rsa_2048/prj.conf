## CMakeLists.txt
```
# SPDX-License-Identifier: Apache-2.0
cmake_minimum_required(VERSION 3.20.0)

# Source to mbedtls which the RSA driver uses for R^2 mod N
list(APPEND ZEPHYR_EXTRA_MODULES
    ${CMAKE_CURRENT_SOURCE_DIR}/../../modules/crypto/mbedtls
)
find_package(Zephyr REQUIRED HINTS $ENV{ZEPHYR_BASE})
project(rsa_2048_tests)

target_sources(app PRIVATE src/main.c)

if(CONFIG_RSA_TEST_OAEP_DECRYPT_01)
    target_sources(app PRIVATE src/test_rsa_oaep_decrypt_01.c)
endif()
if(CONFIG_RSA_TEST_OAEP_DECRYPT_02)
    target_sources(app PRIVATE src/test_rsa_oaep_decrypt_02.c)
endif()
if(CONFIG_RSA_TEST_OAEP_ENCRYPT)
    target_sources(app PRIVATE src/test_rsa_oaep_encrypt.c)
endif()
if(CONFIG_RSA_TEST_PKCS_ENC_DEC)
    target_sources(app PRIVATE src/test_rsa_pkcs_enc_dec.c)
endif()
if(CONFIG_RSA_TEST_PKCS_SIGN_GEN)
    target_sources(app PRIVATE src/test_rsa_pkcs_sign_gen.c)
endif()
if(CONFIG_RSA_TEST_PKCS_SIGN_VERIF)
    target_sources(app PRIVATE src/test_rsa_pkcs_sign_verif.c)
endif()
if(CONFIG_RSA_TEST_PSS_SIGN_GEN)
    target_sources(app PRIVATE src/test_rsa_pss_sign_gen.c)
endif()
if(CONFIG_RSA_TEST_PSS_SIGN_VERIF)
    target_sources(app PRIVATE src/test_rsa_pss_sign_verif.c)
endif()
```

## Kconfig
```
mainmenu "RSA 2048 Test Application"

source "Kconfig.zephyr"

menu "RSA 2048 Tests"

config RSA_TEST_OAEP_DECRYPT_01
    bool "OAEP Decrypt KAT batch 01"
    default n

config RSA_TEST_OAEP_DECRYPT_02
    bool "OAEP Decrypt KAT batch 02"
    default n

config RSA_TEST_OAEP_ENCRYPT
    bool "OAEP Encrypt KAT"
    default n

config RSA_TEST_PKCS_ENC_DEC
    bool "PKCS Encrypt/Decrypt KAT"
    default n

config RSA_TEST_PKCS_SIGN_GEN
    bool "PKCS Sign Generation KAT"
    default n

config RSA_TEST_PKCS_SIGN_VERIF
    bool "PKCS Sign Verification KAT"
    default n

config RSA_TEST_PSS_SIGN_GEN
    bool "PSS Sign Generation KAT"
    default n

config RSA_TEST_PSS_SIGN_VERIF
    bool "PSS Sign Verification KAT"
    default n

endmenu
```

## sample.yaml
```
sample:
  description: RSA sample
    application
  name: rsa2048
common:
  tags: introduction
  integration_platforms:
    - native_posix
  harness: console
  harness_config:
    type: one_line
    regex:
      - "RSA2048 SAMPLE"
tests:
  sample.basic.helloworld:
    tags: introduction
```

## prj.conf
```kconfig
# ---------------- Kernel ----------------
CONFIG_MULTITHREADING=y
CONFIG_MAIN_STACK_SIZE=4096
CONFIG_IDLE_STACK_SIZE=256

# ---------------- C Library (ONE only) ----------------
CONFIG_MINIMAL_LIBC=y
CONFIG_MINIMAL_LIBC_RAND=y
CONFIG_COMMON_LIBC_MALLOC_ARENA_SIZE=8192


# ---------------- RSA Application enable ----------------
CONFIG_RSA_TEST_OAEP_DECRYPT_01=n
CONFIG_RSA_TEST_OAEP_DECRYPT_02=n
CONFIG_RSA_TEST_OAEP_ENCRYPT=n
CONFIG_RSA_TEST_PKCS_ENC_DEC=n
CONFIG_RSA_TEST_PKCS_SIGN_GEN=n
CONFIG_RSA_TEST_PKCS_SIGN_VERIF=n
CONFIG_RSA_TEST_PSS_SIGN_GEN=y
CONFIG_RSA_TEST_PSS_SIGN_VERIF=n

# ---------------- Heap ----------------
CONFIG_HEAP_MEM_POOL_SIZE=8192

# ---------------- mbedTLS ----------------
CONFIG_MBEDTLS=y
CONFIG_MBEDTLS_BUILTIN=y
CONFIG_MBEDTLS_CFG_FILE="config-mbedtls.h"
CONFIG_MBEDTLS_RSA_C=y
CONFIG_MBEDTLS_PKCS1_V15=y
# ---------------- CRYPTO ----------------
CONFIG_CRYPTO=y
CONFIG_CRYPTO_MINDGROVE_RSA=y


# ---------------- UART ----------------
CONFIG_SERIAL=y
CONFIG_UART_MINDGROVE=y
CONFIG_UART_CONSOLE=y
CONFIG_PRINTK=y

# ---------------- Misc ----------------
CONFIG_SIZE_OPTIMIZATIONS=y
```

## src/main.c
```c
#include <zephyr/kernel.h>
#include <zephyr/sys/printk.h>

#if defined(CONFIG_RSA_TEST_OAEP_DECRYPT_01)
int test_rsa_oaep_decrypt_01(void);
#endif
#if defined(CONFIG_RSA_TEST_OAEP_DECRYPT_02)
int test_rsa_oaep_decrypt_02(void);
#endif
#if defined(CONFIG_RSA_TEST_OAEP_ENCRYPT)
int test_rsa_oaep_encrypt(void);
#endif
#if defined(CONFIG_RSA_TEST_PKCS_ENC_DEC)
int test_rsa_pkcs_enc_dec(void);
#endif
#if defined(CONFIG_RSA_TEST_PKCS_SIGN_GEN)
int test_rsa_pkcs_sign_gen(void);
#endif
#if defined(CONFIG_RSA_TEST_PKCS_SIGN_VERIF)
int test_rsa_pkcs_sign_verif(void);
#endif
#if defined(CONFIG_RSA_TEST_PSS_SIGN_GEN)
int test_rsa_pss_sign_gen(void);
#endif
#if defined(CONFIG_RSA_TEST_PSS_SIGN_VERIF)
int test_rsa_pss_sign_verif(void);
#endif

#define RUN(fn, label)                                  \
    do {                                                \
        int _r = fn();                                  \
        printk(label ": %s\n", _r ? "FAILED" : "PASSED"); \
    } while (0)

int main(void)
{
    printk("\n===== Mindgrove RSA2048 Tests =====\n");

#if defined(CONFIG_RSA_TEST_OAEP_DECRYPT_01)
    RUN(test_rsa_oaep_decrypt_01, "OAEP DECRYPT 01");
#endif
#if defined(CONFIG_RSA_TEST_OAEP_DECRYPT_02)
    RUN(test_rsa_oaep_decrypt_02, "OAEP DECRYPT 02");
#endif
#if defined(CONFIG_RSA_TEST_OAEP_ENCRYPT)
    RUN(test_rsa_oaep_encrypt,    "OAEP ENCRYPT");
#endif
#if defined(CONFIG_RSA_TEST_PKCS_ENC_DEC)
    RUN(test_rsa_pkcs_enc_dec,    "PKCS ENC/DEC");
#endif
#if defined(CONFIG_RSA_TEST_PKCS_SIGN_GEN)
    RUN(test_rsa_pkcs_sign_gen,   "PKCS SIGN GEN");
#endif
#if defined(CONFIG_RSA_TEST_PKCS_SIGN_VERIF)
    RUN(test_rsa_pkcs_sign_verif, "PKCS SIGN VERIF");
#endif
#if defined(CONFIG_RSA_TEST_PSS_SIGN_GEN)
    RUN(test_rsa_pss_sign_gen,    "PSS SIGN GEN");
#endif
#if defined(CONFIG_RSA_TEST_PSS_SIGN_VERIF)
    RUN(test_rsa_pss_sign_verif,  "PSS SIGN VERIF");
#endif

    printk("\n===== RSA2048 Tests Complete =====\n");
    return 0;
}
```

## src/test_rsa_helpers.h
```c
#ifndef TEST_RSA_HELPERS_H
#define TEST_RSA_HELPERS_H

#include <stdint.h>
#include <zephyr/sys/printk.h>

static inline void rsa_print_hex(const char *label,
                                  const uint8_t *data, uint16_t len)
{
    printk("%s: ", label);
    for (uint16_t i = 0; i < len; i++)
        printk("%02x", data[i]);
    printk("\n");
}

/* Converts bit length to byte length, rounding up */
static inline uint16_t bits_to_bytes(uint16_t bits)
{
    return (bits + 7) / 8;
}

#endif /* TEST_RSA_HELPERS_H */
```

## src/test_rsa_oaep_decrypt_01.c
```c
#include <zephyr/kernel.h>
#include <zephyr/device.h>
#include <zephyr/crypto/rsa.h>
#include <zephyr/sys/printk.h>
#include <string.h>
#include "oaep_decrypt_kat_testvectors_01.h"

#define RSA_BYTES 256

static const struct device *get_rsa_dev(void)
{
    const struct device *dev = DEVICE_DT_GET(DT_INST(0, mindgrove_rsa2048));
    if (!device_is_ready(dev)) {
        printk("RSA device not ready\n");
        return NULL;
    }
    return dev;
}

int test_rsa_oaep_decrypt_01(void)
{
    const struct device *dev = get_rsa_dev();
    if (!dev) return -ENODEV;
    const struct rsa_mg_driver_api *api = dev->api;

    uint32_t passed = 0, failed = 0;
    uint16_t count = oaep_dec_kat_vectors_count_01;

    for (uint16_t i = 0; i < count; i++) {
        const OAEP_Decrypt_Test_Vectors_01 *tv = &oaep_decrypt_kat_vectors_01[i];
        uint8_t decrypted[RSA_BYTES] __aligned(8) = {0};
        struct rsa_mg_pkt pkt = {0};

        /* Check ciphertext < modulus */
        bool valid = false;
        for (size_t k = 0; k < RSA_BYTES; k++) {
            if (tv->cipher_text[k] < tv->modulus[k]) {
                valid = true; break;
            } else if (tv->cipher_text[k] > tv->modulus[k]) {
                break;
            }
        }
        if (!valid) {
            if (tv->expected_result == 'F') {
                printk("[OAEP DEC 01 %03d] PASS (c>=n, expected fail)\n", i);
                passed++;
            } else {
                printk("[OAEP DEC 01 %03d] FAIL (c>=n but expected pass)\n", i);
                failed++;
            }
            continue;
        }

        pkt.in        = (uint8_t *)tv->cipher_text;
        pkt.in_len    = RSA_BYTES;
        pkt.out       = decrypted;
        pkt.out_len   = RSA_BYTES;
        pkt.exp       = (uint8_t *)tv->private_exponent;
        pkt.mod       = (uint8_t *)tv->modulus;
        pkt.label     = (tv->label_len_bits > 0) ?
                         (uint8_t *)tv->label : NULL;
        pkt.label_len = tv->label_len_bits / 8;

        int ret = api->invoke(dev, RSA_MG_OP_DECRYPT, RSA_MG_PAD_OAEP, &pkt);

        bool ok;
        if (tv->expected_result == 'P') {
            ok = (!ret &&
                  pkt.out_len == (tv->input_len_bits / 8) &&
                  memcmp(tv->input, decrypted, pkt.out_len) == 0);
            printk("[OAEP DEC 01 %03d] %s%s\n", i,
                   ok ? "PASS" : "FAIL",
                   ok ? "" : " (expected pass)");
        } else {
            ok = (ret != 0) ||
                 (pkt.out_len != (tv->input_len_bits / 8)) ||
                 (memcmp(tv->input, decrypted, pkt.out_len) != 0);
            printk("[OAEP DEC 01 %03d] %s%s\n", i,
                   ok ? "PASS" : "FAIL",
                   ok ? " (expected fail)" : " (should have failed)");
        }
        ok ? passed++ : failed++;
    }

    printk("OAEP DECRYPT 01: %d Passed, %d Failed\n", passed, failed);
    return failed ? -EIO : 0;
}
```

## src/test_rsa_oaep_decrypt_02.c
```c
#include <zephyr/kernel.h>
#include <zephyr/device.h>
#include <zephyr/crypto/rsa.h>
#include <zephyr/sys/printk.h>
#include <string.h>

#include "oaep_decrypt_kat_testvectors_02.h"

#define RSA_BYTES 256

static const struct device *get_rsa_dev(void)
{
    const struct device *dev = DEVICE_DT_GET(DT_INST(0, mindgrove_rsa2048));
    if (!device_is_ready(dev)) {
        printk("RSA device not ready\n");
        return NULL;
    }
    return dev;
}

int test_rsa_oaep_decrypt_02(void)
{
    const struct device *dev = get_rsa_dev();
    if (!dev) return -ENODEV;
    const struct rsa_mg_driver_api *api = dev->api;

    uint32_t passed = 0, failed = 0;
    uint16_t count = oaep_dec_kat_vectors_count_02;

    for (uint16_t i = 0; i < count; i++) {
        const OAEP_Decrypt_Test_Vectors_02 *tv = &oaep_decrypt_kat_vectors_02[i];
        uint8_t decrypted[RSA_BYTES] __aligned(8) = {0};
        struct rsa_mg_pkt pkt = {0};

        /* Check ciphertext < modulus */
        bool valid = false;
        for (size_t k = 0; k < RSA_BYTES; k++) {
            if (tv->cipher_text[k] < tv->modulus[k]) {
                valid = true; break;
            } else if (tv->cipher_text[k] > tv->modulus[k]) {
                break;
            }
        }
        if (!valid) {
            if (tv->expected_result == 'F') {
                printk("[OAEP DEC 02 %03d] PASS (c>=n, expected fail)\n", i);
                passed++;
            } else {
                printk("[OAEP DEC 02 %03d] FAIL (c>=n but expected pass)\n", i);
                failed++;
            }
            continue;
        }

        pkt.in        = (uint8_t *)tv->cipher_text;
        pkt.in_len    = RSA_BYTES;
        pkt.out       = decrypted;
        pkt.out_len   = RSA_BYTES;
        pkt.exp       = (uint8_t *)tv->private_exponent;
        pkt.mod       = (uint8_t *)tv->modulus;
        pkt.label     = (tv->label_len_bits > 0) ?
                         (uint8_t *)tv->label : NULL;
        pkt.label_len = tv->label_len_bits / 8;

        int ret = api->invoke(dev, RSA_MG_OP_DECRYPT,
                              RSA_MG_PAD_OAEP, &pkt);

        bool ok;
        if (tv->expected_result == 'P') {
            ok = (!ret &&
                  pkt.out_len == (tv->input_len_bits / 8) &&
                  memcmp(tv->input, decrypted, pkt.out_len) == 0);
            if (!ok)
                printk("[OAEP DEC 02 %03d] FAIL (expected pass)\n", i);
        } else {
            ok = (ret != 0) ||
                 (pkt.out_len != (tv->input_len_bits / 8)) ||
                 (memcmp(tv->input, decrypted, pkt.out_len) != 0);
            if (!ok)
                printk("[OAEP DEC 02 %03d] FAIL (expected fail)\n", i);
        }

        printk("[OAEP DEC 02 %03d] %s\n", i, ok ? "PASS" : "FAIL");
        ok ? passed++ : failed++;
    }

    printk("OAEP DECRYPT 02: %d Passed, %d Failed\n\n", passed, failed);
    return failed ? -EIO : 0;
}
```

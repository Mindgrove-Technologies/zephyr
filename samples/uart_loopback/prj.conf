## CMakeLists.txt
```
# SPDX-License-Identifier: Apache-2.0

cmake_minimum_required(VERSION 3.20.0)

find_package(Zephyr REQUIRED HINTS $ENV{ZEPHYR_BASE})
project(uart_loopback)

target_sources(app PRIVATE src/main.c)
```

## sample.yaml
```
sample:
  description: Uart loopback sample, the simplest Zephyr
    application
  name: Uart loopback
common:
  tags: introduction
  integration_platforms:
    - native_posix
  harness: console
  harness_config:
    type: one_line
    regex:
      - "Uart loopback! (.*)"
tests:
  sample.basic.helloworld:
    tags: introduction
```

## prj.conf
```kconfig
CONFIG_SERIAL=y
CONFIG_UART_MINDGROVE=y
CONFIG_UART_CONSOLE=y
CONFIG_MULTITHREADING=y
CONFIG_PINCTRL=y
CONFIG_PINCTRL_MINDGROVE=y
# CONFIG_PINCTRL_LOG_LEVEL_DBG=y
CONFIG_PRINTK=y
CONFIG_PINCTRL_INIT_PRIORITY=49
# CONFIG_UART_CONSOLE_INIT_PRIORITY=60
# CONFIG_LOG=y
# CONFIG_LOG_DEFAULT_LEVEL=4
```

## src/main.c
```c
#include <stdio.h>
#include <zephyr/device.h>
#include <zephyr/drivers/uart.h>
#include <zephyr/kernel.h>

const struct device *dev = DEVICE_DT_GET(DT_NODELABEL(uart3));

void uart_loopback_test(void)
{
    const char *msg = "Hello from UART\n";
    char recv_char;

    // Send message
    for (int i = 0; msg[i] != '\0'; i++) {
        uart_poll_out(dev, msg[i]);
        // uart_poll_out(dev1, msg[i]);
    }

	k_busy_wait(1000); // 1 ms delay (1000 microseconds)

    // Receive message
    printk("Receive message:\n");
    for (int i = 0; msg[i] != '\0'; i++) {
        if (uart_poll_in(dev, &recv_char) == 0) {
            printk("%c", recv_char);
        }
    }
    printk("\n");
}

void main(void)
{
	printk("Hello world!\n");
    if (!device_is_ready(dev)) {
        printk("UART device is not ready\n");
        return;
    }

	uart_loopback_test();
    printk("completed\n");
}
```

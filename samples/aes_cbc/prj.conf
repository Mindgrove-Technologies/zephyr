## CMakeLists.txt
```
cmake_minimum_required(VERSION 3.20.0)
find_package(Zephyr REQUIRED HINTS $ENV{ZEPHYR_BASE})
project(aes_cbc_tests)

target_sources(app PRIVATE src/main.c)

if(CONFIG_AES_CBC_GFSBOX)
    target_sources(app PRIVATE src/test_aes_cbc_gfsbox.c)
endif()
if(CONFIG_AES_CBC_KEYSBOX_128 OR CONFIG_AES_CBC_KEYSBOX_192 OR CONFIG_AES_CBC_KEYSBOX_256)
    target_sources(app PRIVATE src/test_aes_cbc_keysbox.c)
endif()
if(CONFIG_AES_CBC_MMT)
    target_sources(app PRIVATE src/test_aes_cbc_mmt.c)
endif()

if(CONFIG_AES_CBC_MCT)
    target_sources(app PRIVATE src/test_aes_cbc_mct.c)
endif()

# VARKEY
if(CONFIG_AES_CBC_VARKEY_128_01 OR CONFIG_AES_CBC_VARKEY_128_02 OR
   CONFIG_AES_CBC_VARKEY_128_03 OR CONFIG_AES_CBC_VARKEY_128_04 OR
   CONFIG_AES_CBC_VARKEY_128_05 OR CONFIG_AES_CBC_VARKEY_128_06)
    target_sources(app PRIVATE src/test_aes_cbc_varkey_128.c)
endif()

if(CONFIG_AES_CBC_VARKEY_192_01 OR CONFIG_AES_CBC_VARKEY_192_02 OR
   CONFIG_AES_CBC_VARKEY_192_03 OR CONFIG_AES_CBC_VARKEY_192_04 OR
   CONFIG_AES_CBC_VARKEY_192_05 OR CONFIG_AES_CBC_VARKEY_192_06 OR
   CONFIG_AES_CBC_VARKEY_192_07 OR CONFIG_AES_CBC_VARKEY_192_08)
    target_sources(app PRIVATE src/test_aes_cbc_varkey_192.c)
endif()

if(CONFIG_AES_CBC_VARKEY_256_01 OR CONFIG_AES_CBC_VARKEY_256_02 OR
   CONFIG_AES_CBC_VARKEY_256_03 OR CONFIG_AES_CBC_VARKEY_256_04 OR
   CONFIG_AES_CBC_VARKEY_256_05 OR CONFIG_AES_CBC_VARKEY_256_06 OR
   CONFIG_AES_CBC_VARKEY_256_07 OR CONFIG_AES_CBC_VARKEY_256_08 OR
   CONFIG_AES_CBC_VARKEY_256_09 OR CONFIG_AES_CBC_VARKEY_256_10 OR
   CONFIG_AES_CBC_VARKEY_256_11)
    target_sources(app PRIVATE src/test_aes_cbc_varkey_256.c)
endif()

# VARTXT 128
if(CONFIG_AES_CBC_VARTXT_128_01 OR CONFIG_AES_CBC_VARTXT_128_02 OR
   CONFIG_AES_CBC_VARTXT_128_03 OR CONFIG_AES_CBC_VARTXT_128_04 OR
   CONFIG_AES_CBC_VARTXT_128_05 OR CONFIG_AES_CBC_VARTXT_128_06)
    target_sources(app PRIVATE src/test_aes_cbc_vartxt_128.c)
endif()

if(CONFIG_AES_CBC_VARTXT_192_01 OR CONFIG_AES_CBC_VARTXT_192_02 OR
   CONFIG_AES_CBC_VARTXT_192_03 OR CONFIG_AES_CBC_VARTXT_192_04 OR
   CONFIG_AES_CBC_VARTXT_192_05 OR CONFIG_AES_CBC_VARTXT_192_06)
    target_sources(app PRIVATE src/test_aes_cbc_vartxt_192.c)
endif()

if(CONFIG_AES_CBC_VARTXT_256_01 OR CONFIG_AES_CBC_VARTXT_256_02 OR
   CONFIG_AES_CBC_VARTXT_256_03 OR CONFIG_AES_CBC_VARTXT_256_04 OR
   CONFIG_AES_CBC_VARTXT_256_05 OR CONFIG_AES_CBC_VARTXT_256_06)
    target_sources(app PRIVATE src/test_aes_cbc_vartxt_256.c)
endif()
```

## Kconfig
```
mainmenu "AES CBC Test Suite"

source "Kconfig.zephyr"

config AES_CBC_TEST_SUITE
    bool "Enable AES CBC Test Suite Infrastructure"
    default y
    select CRYPTO
    help
      Master switch for the AES CBC testing suite.

if AES_CBC_TEST_SUITE

choice AES_CBC_TEST_SELECTION
    prompt "Active AES CBC Test Variant"
    default AES_CBC_GFSBOX
    help
      Due to strict hardware memory limits, you may only select 
      ONE test variant to compile into the binary at any given time.

    # --- Fixed Tests ---
    config AES_CBC_GFSBOX
        bool "GFSbox (128+192+256) ~24KB"

    config AES_CBC_KEYSBOX_128
        bool "AES CBC Keysbox 128-bit test"

    config AES_CBC_KEYSBOX_192
        bool "AES CBC Keysbox 192-bit test"

    config AES_CBC_KEYSBOX_256
        bool "AES CBC Keysbox 256-bit test"

    config AES_CBC_MMT
        bool "MMT (128+192+256) ~18KB"

    config AES_CBC_MCT
        bool "Monte Carlo Test"

    # --- VARKEY 128-bit ---
    config AES_CBC_VARKEY_128_01
        bool "VARKEY 128 batch 01 (~28KB)"
    config AES_CBC_VARKEY_128_02
        bool "VARKEY 128 batch 02 (~28KB)"
    config AES_CBC_VARKEY_128_03
        bool "VARKEY 128 batch 03 (~28KB)"
    config AES_CBC_VARKEY_128_04
        bool "VARKEY 128 batch 04 (~28KB)"
    config AES_CBC_VARKEY_128_05
        bool "VARKEY 128 batch 05 (~28KB)"
    config AES_CBC_VARKEY_128_06
        bool "VARKEY 128 batch 06 (~28KB)"

    # --- VARKEY 192-bit ---
    config AES_CBC_VARKEY_192_01
        bool "VARKEY 192 batch 01 (~28KB)"
    config AES_CBC_VARKEY_192_02
        bool "VARKEY 192 batch 02 (~28KB)"
    config AES_CBC_VARKEY_192_03
        bool "VARKEY 192 batch 03 (~28KB)"
    config AES_CBC_VARKEY_192_04
        bool "VARKEY 192 batch 04 (~28KB)"
    config AES_CBC_VARKEY_192_05
        bool "VARKEY 192 batch 05 (~28KB)"
    config AES_CBC_VARKEY_192_06
        bool "VARKEY 192 batch 06 (~28KB)"
    config AES_CBC_VARKEY_192_07
        bool "VARKEY 192 batch 07 (~28KB)"
    config AES_CBC_VARKEY_192_08
        bool "VARKEY 192 batch 08 (~28KB)"

    # --- VARKEY 256-bit ---
    config AES_CBC_VARKEY_256_01
        bool "VARKEY 256 batch 01 (~28KB)"
    config AES_CBC_VARKEY_256_02
        bool "VARKEY 256 batch 02 (~28KB)"
    config AES_CBC_VARKEY_256_03
        bool "VARKEY 256 batch 03 (~28KB)"
    config AES_CBC_VARKEY_256_04
        bool "VARKEY 256 batch 04 (~28KB)"
    config AES_CBC_VARKEY_256_05
        bool "VARKEY 256 batch 05 (~28KB)"
    config AES_CBC_VARKEY_256_06
        bool "VARKEY 256 batch 06 (~28KB)"
    config AES_CBC_VARKEY_256_07
        bool "VARKEY 256 batch 07 (~28KB)"
    config AES_CBC_VARKEY_256_08
        bool "VARKEY 256 batch 08 (~28KB)"
    config AES_CBC_VARKEY_256_09
        bool "VARKEY 256 batch 09 (~28KB)"
    config AES_CBC_VARKEY_256_10
        bool "VARKEY 256 batch 10 (~28KB)"
    config AES_CBC_VARKEY_256_11
        bool "VARKEY 256 batch 11 (~28KB)"

    # --- VARTXT 128-bit ---
    config AES_CBC_VARTXT_128_01
        bool "VARTXT 128 batch 01 (~28KB)"
    config AES_CBC_VARTXT_128_02
        bool "VARTXT 128 batch 02 (~28KB)"
    config AES_CBC_VARTXT_128_03
        bool "VARTXT 128 batch 03 (~28KB)"
    config AES_CBC_VARTXT_128_04
        bool "VARTXT 128 batch 04 (~28KB)"
    config AES_CBC_VARTXT_128_05
        bool "VARTXT 128 batch 05 (~28KB)"
    config AES_CBC_VARTXT_128_06
        bool "VARTXT 128 batch 06 (~28KB)"

    # --- VARTXT 192-bit ---
    config AES_CBC_VARTXT_192_01
        bool "VARTXT 192 batch 01 (~28KB)"
    config AES_CBC_VARTXT_192_02
        bool "VARTXT 192 batch 02 (~28KB)"
    config AES_CBC_VARTXT_192_03
        bool "VARTXT 192 batch 03 (~28KB)"
    config AES_CBC_VARTXT_192_04
        bool "VARTXT 192 batch 04 (~28KB)"
    config AES_CBC_VARTXT_192_05
        bool "VARTXT 192 batch 05 (~28KB)"
    config AES_CBC_VARTXT_192_06
        bool "VARTXT 192 batch 06 (~28KB)"

    # --- VARTXT 256-bit ---
    config AES_CBC_VARTXT_256_01
        bool "VARTXT 256 batch 01 (~28KB)"
    config AES_CBC_VARTXT_256_02
        bool "VARTXT 256 batch 02 (~28KB)"
    config AES_CBC_VARTXT_256_03
        bool "VARTXT 256 batch 03 (~28KB)"
    config AES_CBC_VARTXT_256_04
        bool "VARTXT 256 batch 04 (~28KB)"
    config AES_CBC_VARTXT_256_05
        bool "VARTXT 256 batch 05 (~28KB)"
    config AES_CBC_VARTXT_256_06
        bool "VARTXT 256 batch 06 (~28KB)"

endchoice

endif # AES_CBC_TEST_SUITE
```

## prj.conf
```kconfig
# ---------------- Kernel ----------------
CONFIG_MULTITHREADING=n
CONFIG_MAIN_STACK_SIZE=2048
CONFIG_IDLE_STACK_SIZE=256

# # ---------------- Crypto ----------------
CONFIG_CRYPTO=y
CONFIG_CRYPTO_MINDGROVE_AES=y


CONFIG_AES_CBC_GFSBOX=n
CONFIG_AES_CBC_KEYSBOX_128=n
CONFIG_AES_CBC_KEYSBOX_192=n
CONFIG_AES_CBC_KEYSBOX_256=n
CONFIG_AES_CBC_MMT=n
CONFIG_AES_CBC_MCT=y

# AES CBC VARTXT 128 (01-06)
CONFIG_AES_CBC_VARKEY_128_01=n
CONFIG_AES_CBC_VARKEY_128_02=n
CONFIG_AES_CBC_VARKEY_128_03=n
CONFIG_AES_CBC_VARKEY_128_04=n
CONFIG_AES_CBC_VARKEY_128_05=n
CONFIG_AES_CBC_VARKEY_128_06=n

# AES CBC VARTXT 192 (01-08)
CONFIG_AES_CBC_VARKEY_192_01=n
CONFIG_AES_CBC_VARKEY_192_02=n
CONFIG_AES_CBC_VARKEY_192_03=n
CONFIG_AES_CBC_VARKEY_192_04=n
CONFIG_AES_CBC_VARKEY_192_05=n
CONFIG_AES_CBC_VARKEY_192_06=n
CONFIG_AES_CBC_VARKEY_192_07=n
CONFIG_AES_CBC_VARKEY_192_08=n

# AES CBC VARTXT 256 (01-11)
CONFIG_AES_CBC_VARKEY_256_01=n
CONFIG_AES_CBC_VARKEY_256_02=n
CONFIG_AES_CBC_VARKEY_256_03=n
CONFIG_AES_CBC_VARKEY_256_04=n
CONFIG_AES_CBC_VARKEY_256_05=n
CONFIG_AES_CBC_VARKEY_256_06=n
CONFIG_AES_CBC_VARKEY_256_07=n
CONFIG_AES_CBC_VARKEY_256_08=n
CONFIG_AES_CBC_VARKEY_256_09=n
CONFIG_AES_CBC_VARKEY_256_10=n
CONFIG_AES_CBC_VARKEY_256_11=n

# AES CBC VARTXT 128 (01-06)
CONFIG_AES_CBC_VARTXT_128_01=n
CONFIG_AES_CBC_VARTXT_128_02=n
CONFIG_AES_CBC_VARTXT_128_03=n
CONFIG_AES_CBC_VARTXT_128_04=n
CONFIG_AES_CBC_VARTXT_128_05=n
CONFIG_AES_CBC_VARTXT_128_06=n

# AES CBC VARTXT 192 (01-06)
CONFIG_AES_CBC_VARTXT_192_01=n
CONFIG_AES_CBC_VARTXT_192_02=n
CONFIG_AES_CBC_VARTXT_192_03=n
CONFIG_AES_CBC_VARTXT_192_04=n
CONFIG_AES_CBC_VARTXT_192_05=n
CONFIG_AES_CBC_VARTXT_192_06=n

# AES CBC VARTXT 256 (01-06)
CONFIG_AES_CBC_VARTXT_256_01=n
CONFIG_AES_CBC_VARTXT_256_02=n
CONFIG_AES_CBC_VARTXT_256_03=n
CONFIG_AES_CBC_VARTXT_256_04=n
CONFIG_AES_CBC_VARTXT_256_05=n
CONFIG_AES_CBC_VARTXT_256_06=n
# ---------------- UART / printk ---------
CONFIG_SERIAL=y
CONFIG_UART_MINDGROVE=y
CONFIG_CONSOLE=y
CONFIG_UART_CONSOLE=y
CONFIG_PRINTK=y

# ---------------- Memory ----------------
CONFIG_HEAP_MEM_POOL_SIZE=0

# ---------------- Disable bloat ---------
CONFIG_LOG=n
CONFIG_ASSERT=n
CONFIG_DEBUG=n
CONFIG_POSIX_API=n
CONFIG_TIMING_FUNCTIONS=n
CONFIG_HEAP_MEM_POOL_SIZE=2048

# # ---------------- Libc ------------------
# CONFIG_MINIMAL_LIBC=y
# CONFIG_NEWLIB_LIBC=n
CONFIG_MINIMAL_LIBC_RAND=y

# ---------------- Size ------------------
CONFIG_SIZE_OPTIMIZATIONS=y
```

## src/main.c
```c
#include <zephyr/kernel.h>
#include <zephyr/sys/printk.h>

/* * NOTE ON MEMORY CONSTRAINTS: 
 * Due to strict hardware memory limits, only ONE CONFIG_AES_CBC_* test 
 * variant should be enabled in prj.conf / Kconfig at any given time.
 */

/* --- 1. Function Declarations --- */
#if defined(CONFIG_AES_CBC_GFSBOX)
int test_aes_cbc_gfsbox(void);
#endif

#if defined(CONFIG_AES_CBC_KEYSBOX_128) || \
    defined(CONFIG_AES_CBC_KEYSBOX_192) || \
    defined(CONFIG_AES_CBC_KEYSBOX_256)
int test_aes_cbc_keysbox(void);
#endif

#if defined(CONFIG_AES_CBC_MMT)
int test_aes_cbc_mmt(void);
#endif

/* Added & corrected: Links explicitly to your MCT test suite component */
#if defined(CONFIG_AES_CBC_MCT)
int test_aes_cbc_mct(void);
#endif

#if defined(CONFIG_AES_CBC_VARKEY_128_01) || defined(CONFIG_AES_CBC_VARKEY_128_02) || \
    defined(CONFIG_AES_CBC_VARKEY_128_03) || defined(CONFIG_AES_CBC_VARKEY_128_04) || \
    defined(CONFIG_AES_CBC_VARKEY_128_05) || defined(CONFIG_AES_CBC_VARKEY_128_06)
int test_aes_cbc_varkey_128(void);
#endif

#if defined(CONFIG_AES_CBC_VARKEY_192_01) || defined(CONFIG_AES_CBC_VARKEY_192_02) || \
    defined(CONFIG_AES_CBC_VARKEY_192_03) || defined(CONFIG_AES_CBC_VARKEY_192_04) || \
    defined(CONFIG_AES_CBC_VARKEY_192_05) || defined(CONFIG_AES_CBC_VARKEY_192_06) || \
    defined(CONFIG_AES_CBC_VARKEY_192_07) || defined(CONFIG_AES_CBC_VARKEY_192_08)
int test_aes_cbc_varkey_192(void);
#endif

#if defined(CONFIG_AES_CBC_VARKEY_256_01) || defined(CONFIG_AES_CBC_VARKEY_256_02) || \
    defined(CONFIG_AES_CBC_VARKEY_256_03) || defined(CONFIG_AES_CBC_VARKEY_256_04) || \
    defined(CONFIG_AES_CBC_VARKEY_256_05) || defined(CONFIG_AES_CBC_VARKEY_256_06) || \
    defined(CONFIG_AES_CBC_VARKEY_256_07) || defined(CONFIG_AES_CBC_VARKEY_256_08) || \
    defined(CONFIG_AES_CBC_VARKEY_256_09) || defined(CONFIG_AES_CBC_VARKEY_256_10) || \
    defined(CONFIG_AES_CBC_VARKEY_256_11)
int test_aes_cbc_varkey_256(void);
#endif

#if defined(CONFIG_AES_CBC_VARTXT_128_01) || defined(CONFIG_AES_CBC_VARTXT_128_02) || \
    defined(CONFIG_AES_CBC_VARTXT_128_03) || defined(CONFIG_AES_CBC_VARTXT_128_04) || \
    defined(CONFIG_AES_CBC_VARTXT_128_05) || defined(CONFIG_AES_CBC_VARTXT_128_06)
int test_aes_cbc_vartxt_128(void);
#endif

#if defined(CONFIG_AES_CBC_VARTXT_192_01) || defined(CONFIG_AES_CBC_VARTXT_192_02) || \
    defined(CONFIG_AES_CBC_VARTXT_192_03) || defined(CONFIG_AES_CBC_VARTXT_192_04) || \
    defined(CONFIG_AES_CBC_VARTXT_192_05) || defined(CONFIG_AES_CBC_VARTXT_192_06)
int test_aes_cbc_vartxt_192(void);
#endif

#if defined(CONFIG_AES_CBC_VARTXT_256_01) || defined(CONFIG_AES_CBC_VARTXT_256_02) || \
    defined(CONFIG_AES_CBC_VARTXT_256_03) || defined(CONFIG_AES_CBC_VARTXT_256_04) || \
    defined(CONFIG_AES_CBC_VARTXT_256_05) || defined(CONFIG_AES_CBC_VARTXT_256_06)
int test_aes_cbc_vartxt_256(void);
#endif

/* --- 2. Test Runner Infrastructure --- */
#define RUN(fn, label) \
    do { int _r = fn(); \
         printk(label ": %s\n", _r ? "FAILED" : "PASSED"); } while(0)

int main(void)
{
    printk("\n===== AES CBC Single-Test Execution =====\n");

#if defined(CONFIG_AES_CBC_GFSBOX)
    RUN(test_aes_cbc_gfsbox,  "CBC GFSBOX");
#endif
#if defined(CONFIG_AES_CBC_KEYSBOX_128) || defined(CONFIG_AES_CBC_KEYSBOX_192) || defined(CONFIG_AES_CBC_KEYSBOX_256)
    RUN(test_aes_cbc_keysbox, "CBC KEYSBOX");
#endif
#if defined(CONFIG_AES_CBC_MMT)
    RUN(test_aes_cbc_mmt,     "CBC MMT");
#endif

    /* Added: Calls your new Monte Carlo Test engine when enabled via Kconfig */
#if defined(CONFIG_AES_CBC_MCT)
    test_aes_cbc_mct();
#endif

    /* VARKEY 128 */
#if defined(CONFIG_AES_CBC_VARKEY_128_01)
    RUN(test_aes_cbc_varkey_128, "CBC VARKEY 128-01");
#endif
#if defined(CONFIG_AES_CBC_VARKEY_128_02)
    RUN(test_aes_cbc_varkey_128, "CBC VARKEY 128-02");
#endif
#if defined(CONFIG_AES_CBC_VARKEY_128_03)
    RUN(test_aes_cbc_varkey_128, "CBC VARKEY 128-03");
#endif
#if defined(CONFIG_AES_CBC_VARKEY_128_04)
    RUN(test_aes_cbc_varkey_128, "CBC VARKEY 128-04");
#endif
#if defined(CONFIG_AES_CBC_VARKEY_128_05)
    RUN(test_aes_cbc_varkey_128, "CBC VARKEY 128-05");
#endif
#if defined(CONFIG_AES_CBC_VARKEY_128_06)
    RUN(test_aes_cbc_varkey_128, "CBC VARKEY 128-06");
#endif

    /* VARKEY 192 */
#if defined(CONFIG_AES_CBC_VARKEY_192_01)
    RUN(test_aes_cbc_varkey_192, "CBC VARKEY 192-01");
#endif
#if defined(CONFIG_AES_CBC_VARKEY_192_02)
    RUN(test_aes_cbc_varkey_192, "CBC VARKEY 192-02");
#endif
#if defined(CONFIG_AES_CBC_VARKEY_192_03)
    RUN(test_aes_cbc_varkey_192, "CBC VARKEY 192-03");
#endif
#if defined(CONFIG_AES_CBC_VARKEY_192_04)
    RUN(test_aes_cbc_varkey_192, "CBC VARKEY 192-04");
#endif
#if defined(CONFIG_AES_CBC_VARKEY_192_05)
    RUN(test_aes_cbc_varkey_192, "CBC VARKEY 192-05");
#endif
#if defined(CONFIG_AES_CBC_VARKEY_192_06)
    RUN(test_aes_cbc_varkey_192, "CBC VARKEY 192-06");
#endif
#if defined(CONFIG_AES_CBC_VARKEY_192_07)
    RUN(test_aes_cbc_varkey_192, "CBC VARKEY 192-07");
#endif
#if defined(CONFIG_AES_CBC_VARKEY_192_08)
    RUN(test_aes_cbc_varkey_192, "CBC VARKEY 192-08");
#endif

    /* VARKEY 256 */
#if defined(CONFIG_AES_CBC_VARKEY_256_01)
    RUN(test_aes_cbc_varkey_256, "CBC VARKEY 256-01");
#endif
#if defined(CONFIG_AES_CBC_VARKEY_256_02)
    RUN(test_aes_cbc_varkey_256, "CBC VARKEY 256-02");
#endif
#if defined(CONFIG_AES_CBC_VARKEY_256_03)
    RUN(test_aes_cbc_varkey_256, "CBC VARKEY 256-03");
#endif
#if defined(CONFIG_AES_CBC_VARKEY_256_04)
    RUN(test_aes_cbc_varkey_256, "CBC VARKEY 256-04");
#endif
#if defined(CONFIG_AES_CBC_VARKEY_256_05)
    RUN(test_aes_cbc_varkey_256, "CBC VARKEY 256-05");
#endif
#if defined(CONFIG_AES_CBC_VARKEY_256_06)
    RUN(test_aes_cbc_varkey_256, "CBC VARKEY 256-06");
#endif
#if defined(CONFIG_AES_CBC_VARKEY_256_07)
    RUN(test_aes_cbc_varkey_256, "CBC VARKEY 256-07");
#endif
#if defined(CONFIG_AES_CBC_VARKEY_256_08)
    RUN(test_aes_cbc_varkey_256, "CBC VARKEY 256-08");
#endif
#if defined(CONFIG_AES_CBC_VARKEY_256_09)
    RUN(test_aes_cbc_varkey_256, "CBC VARKEY 256-09");
#endif
#if defined(CONFIG_AES_CBC_VARKEY_256_10)
    RUN(test_aes_cbc_varkey_256, "CBC VARKEY 256-10");
#endif
#if defined(CONFIG_AES_CBC_VARKEY_256_11)
    RUN(test_aes_cbc_varkey_256, "CBC VARKEY 256-11");
#endif

    /* VARTXT 128 */
#if defined(CONFIG_AES_CBC_VARTXT_128_01)
    RUN(test_aes_cbc_vartxt_128, "CBC VARTXT 128-01");
#endif
#if defined(CONFIG_AES_CBC_VARTXT_128_02)
    RUN(test_aes_cbc_vartxt_128, "CBC VARTXT 128-02");
#endif
#if defined(CONFIG_AES_CBC_VARTXT_128_03)
    RUN(test_aes_cbc_vartxt_128, "CBC VARTXT 128-03");
#endif
#if defined(CONFIG_AES_CBC_VARTXT_128_04)
    RUN(test_aes_cbc_vartxt_128, "CBC VARTXT 128-04");
#endif
#if defined(CONFIG_AES_CBC_VARTXT_128_05)
    RUN(test_aes_cbc_vartxt_128, "CBC VARTXT 128-05");
#endif
#if defined(CONFIG_AES_CBC_VARTXT_128_06)
    RUN(test_aes_cbc_vartxt_128, "CBC VARTXT 128-06");
#endif

    /* VARTXT 192 */
#if defined(CONFIG_AES_CBC_VARTXT_192_01)
    RUN(test_aes_cbc_vartxt_192, "CBC VARTXT 192-01");
#endif
#if defined(CONFIG_AES_CBC_VARTXT_192_02)
    RUN(test_aes_cbc_vartxt_192, "CBC VARTXT 192-02");
#endif
#if defined(CONFIG_AES_CBC_VARTXT_192_03)
    RUN(test_aes_cbc_vartxt_192, "CBC VARTXT 192-03");
#endif
#if defined(CONFIG_AES_CBC_VARTXT_192_04)
    RUN(test_aes_cbc_vartxt_192, "CBC VARTXT 192-04");
#endif
#if defined(CONFIG_AES_CBC_VARTXT_192_05)
    RUN(test_aes_cbc_vartxt_192, "CBC VARTXT 192-05");
#endif
#if defined(CONFIG_AES_CBC_VARTXT_192_06)
    RUN(test_aes_cbc_vartxt_192, "CBC VARTXT 192-06");
#endif

    /* VARTXT 256 */
#if defined(CONFIG_AES_CBC_VARTXT_256_01)
    RUN(test_aes_cbc_vartxt_256, "CBC VARTXT 256-01");
#endif
#if defined(CONFIG_AES_CBC_VARTXT_256_02)
    RUN(test_aes_cbc_vartxt_256, "CBC VARTXT 256-02");
#endif
#if defined(CONFIG_AES_CBC_VARTXT_256_03)
    RUN(test_aes_cbc_vartxt_256, "CBC VARTXT 256-03");
#endif
#if defined(CONFIG_AES_CBC_VARTXT_256_04)
    RUN(test_aes_cbc_vartxt_256, "CBC VARTXT 256-04");
#endif
#if defined(CONFIG_AES_CBC_VARTXT_256_05)
    RUN(test_aes_cbc_vartxt_256, "CBC VARTXT 256-05");
#endif
#if defined(CONFIG_AES_CBC_VARTXT_256_06)
    RUN(test_aes_cbc_vartxt_256, "CBC VARTXT 256-06");
#endif

    printk("\n===== Execution Complete =====\n");
    return 0;
}
```

## src/aes128_cbc_gfsbox.h
```c
#ifndef AES_128_CBC_GFSBOX_TESTVECTORS_H
#define AES_128_CBC_GFSBOX_TESTVECTORS_H

#include <stdint.h>
#define AES_CBC 1

typedef struct {
    const char* test_id;
    uint8_t     key[32];
    uint16_t    key_len;
    uint8_t     iv[16];
    uint16_t    iv_len;
    uint8_t     plaintext[256];
    uint16_t    pt_len;
    uint8_t     ciphertext[256];
    uint16_t    ct_len;
    uint8_t     mode;
} CBC_GFSbox_128_KAT_Test_Vectors;

/* CBC 128-bit  GFSBOX  —  14 test vectors */
static const CBC_GFSbox_128_KAT_Test_Vectors cbc_gfsbox_128_kat_vectors[] = {

    /* ── CBC_GFSBOX_128_KAT_01 ── */
    {
        .test_id    = "CBC_GFSBOX_128_KAT_01",
        .key        = {
            0x00, 0x00, 0x00, 0x00, 0x00, 0x00, 0x00, 0x00, 0x00, 0x00, 0x00, 0x00, 0x00, 0x00, 0x00, 0x00
        },
        .key_len    = 16,
        .iv         = {
            0x00, 0x00, 0x00, 0x00, 0x00, 0x00, 0x00, 0x00, 0x00, 0x00, 0x00, 0x00, 0x00, 0x00, 0x00, 0x00
        },
        .iv_len     = 16,
        .plaintext  = {
            0xF3, 0x44, 0x81, 0xEC, 0x3C, 0xC6, 0x27, 0xBA, 0xCD, 0x5D, 0xC3, 0xFB, 0x08, 0xF2, 0x73, 0xE6
        },
        .pt_len     = 16,
        .ciphertext = {
            0x03, 0x36, 0x76, 0x3E, 0x96, 0x6D, 0x92, 0x59, 0x5A, 0x56, 0x7C, 0xC9, 0xCE, 0x53, 0x7F, 0x5E
        },
        .ct_len     = 16,
        .mode       = AES_CBC,
    },

    /* ── CBC_GFSBOX_128_KAT_02 ── */
    {
        .test_id    = "CBC_GFSBOX_128_KAT_02",
        .key        = {
            0x00, 0x00, 0x00, 0x00, 0x00, 0x00, 0x00, 0x00, 0x00, 0x00, 0x00, 0x00, 0x00, 0x00, 0x00, 0x00
        },
        .key_len    = 16,
        .iv         = {
            0x00, 0x00, 0x00, 0x00, 0x00, 0x00, 0x00, 0x00, 0x00, 0x00, 0x00, 0x00, 0x00, 0x00, 0x00, 0x00
        },
        .iv_len     = 16,
        .plaintext  = {
            0x97, 0x98, 0xC4, 0x64, 0x0B, 0xAD, 0x75, 0xC7, 0xC3, 0x22, 0x7D, 0xB9, 0x10, 0x17, 0x4E, 0x72
        },
        .pt_len     = 16,
        .ciphertext = {
            0xA9, 0xA1, 0x63, 0x1B, 0xF4, 0x99, 0x69, 0x54, 0xEB, 0xC0, 0x93, 0x95, 0x7B, 0x23, 0x45, 0x89
        },
        .ct_len     = 16,
        .mode       = AES_CBC,
    },

    /* ── CBC_GFSBOX_128_KAT_03 ── */
    {
        .test_id    = "CBC_GFSBOX_128_KAT_03",
        .key        = {
            0x00, 0x00, 0x00, 0x00, 0x00, 0x00, 0x00, 0x00, 0x00, 0x00, 0x00, 0x00, 0x00, 0x00, 0x00, 0x00
        },
        .key_len    = 16,
        .iv         = {
            0x00, 0x00, 0x00, 0x00, 0x00, 0x00, 0x00, 0x00, 0x00, 0x00, 0x00, 0x00, 0x00, 0x00, 0x00, 0x00
        },
        .iv_len     = 16,
        .plaintext  = {
            0x96, 0xAB, 0x5C, 0x2F, 0xF6, 0x12, 0xD9, 0xDF, 0xAA, 0xE8, 0xC3, 0x1F, 0x30, 0xC4, 0x21, 0x68
        },
        .pt_len     = 16,
        .ciphertext = {
            0xFF, 0x4F, 0x83, 0x91, 0xA6, 0xA4, 0x0C, 0xA5, 0xB2, 0x5D, 0x23, 0xBE, 0xDD, 0x44, 0xA5, 0x97
        },
        .ct_len     = 16,
        .mode       = AES_CBC,
    },

    /* ── CBC_GFSBOX_128_KAT_04 ── */
    {
        .test_id    = "CBC_GFSBOX_128_KAT_04",
        .key        = {
            0x00, 0x00, 0x00, 0x00, 0x00, 0x00, 0x00, 0x00, 0x00, 0x00, 0x00, 0x00, 0x00, 0x00, 0x00, 0x00
        },
        .key_len    = 16,
        .iv         = {
            0x00, 0x00, 0x00, 0x00, 0x00, 0x00, 0x00, 0x00, 0x00, 0x00, 0x00, 0x00, 0x00, 0x00, 0x00, 0x00
        },
        .iv_len     = 16,
        .plaintext  = {
            0x6A, 0x11, 0x8A, 0x87, 0x45, 0x19, 0xE6, 0x4E, 0x99, 0x63, 0x79, 0x8A, 0x50, 0x3F, 0x1D, 0x35
        },
        .pt_len     = 16,
        .ciphertext = {
            0xDC, 0x43, 0xBE, 0x40, 0xBE, 0x0E, 0x53, 0x71, 0x2F, 0x7E, 0x2B, 0xF5, 0xCA, 0x70, 0x72, 0x09
        },
        .ct_len     = 16,
        .mode       = AES_CBC,
    },

    /* ── CBC_GFSBOX_128_KAT_05 ── */
    {
        .test_id    = "CBC_GFSBOX_128_KAT_05",
        .key        = {
            0x00, 0x00, 0x00, 0x00, 0x00, 0x00, 0x00, 0x00, 0x00, 0x00, 0x00, 0x00, 0x00, 0x00, 0x00, 0x00
        },
        .key_len    = 16,
        .iv         = {
            0x00, 0x00, 0x00, 0x00, 0x00, 0x00, 0x00, 0x00, 0x00, 0x00, 0x00, 0x00, 0x00, 0x00, 0x00, 0x00
        },
        .iv_len     = 16,
        .plaintext  = {
            0xCB, 0x9F, 0xCE, 0xEC, 0x81, 0x28, 0x6C, 0xA3, 0xE9, 0x89, 0xBD, 0x97, 0x9B, 0x0C, 0xB2, 0x84
        },
        .pt_len     = 16,
        .ciphertext = {
            0x92, 0xBE, 0xED, 0xAB, 0x18, 0x95, 0xA9, 0x4F, 0xAA, 0x69, 0xB6, 0x32, 0xE5, 0xCC, 0x47, 0xCE
        },
        .ct_len     = 16,
        .mode       = AES_CBC,
    },

    /* ── CBC_GFSBOX_128_KAT_06 ── */
    {
        .test_id    = "CBC_GFSBOX_128_KAT_06",
        .key        = {
            0x00, 0x00, 0x00, 0x00, 0x00, 0x00, 0x00, 0x00, 0x00, 0x00, 0x00, 0x00, 0x00, 0x00, 0x00, 0x00
        },
        .key_len    = 16,
        .iv         = {
            0x00, 0x00, 0x00, 0x00, 0x00, 0x00, 0x00, 0x00, 0x00, 0x00, 0x00, 0x00, 0x00, 0x00, 0x00, 0x00
        },
        .iv_len     = 16,
        .plaintext  = {
            0xB2, 0x6A, 0xEB, 0x18, 0x74, 0xE4, 0x7C, 0xA8, 0x35, 0x8F, 0xF2, 0x23, 0x78, 0xF0, 0x91, 0x44
        },
        .pt_len     = 16,
        .ciphertext = {
            0x45, 0x92, 0x64, 0xF4, 0x79, 0x8F, 0x6A, 0x78, 0xBA, 0xCB, 0x89, 0xC1, 0x5E, 0xD3, 0xD6, 0x01
        },
        .ct_len     = 16,
        .mode       = AES_CBC,
    },

    /* ── CBC_GFSBOX_128_KAT_07 ── */
    {
        .test_id    = "CBC_GFSBOX_128_KAT_07",
        .key        = {
            0x00, 0x00, 0x00, 0x00, 0x00, 0x00, 0x00, 0x00, 0x00, 0x00, 0x00, 0x00, 0x00, 0x00, 0x00, 0x00
        },
        .key_len    = 16,
        .iv         = {
            0x00, 0x00, 0x00, 0x00, 0x00, 0x00, 0x00, 0x00, 0x00, 0x00, 0x00, 0x00, 0x00, 0x00, 0x00, 0x00
        },
        .iv_len     = 16,
        .plaintext  = {
            0x58, 0xC8, 0xE0, 0x0B, 0x26, 0x31, 0x68, 0x6D, 0x54, 0xEA, 0xB8, 0x4B, 0x91, 0xF0, 0xAC, 0xA1
        },
        .pt_len     = 16,
        .ciphertext = {
            0x08, 0xA4, 0xE2, 0xEF, 0xEC, 0x8A, 0x8E, 0x33, 0x12, 0xCA, 0x74, 0x60, 0xB9, 0x04, 0x0B, 0xBF
        },
        .ct_len     = 16,
        .mode       = AES_CBC,
    },

    /* ── CBC_GFSBOX_128_KAT_08 ── */
    {
        .test_id    = "CBC_GFSBOX_128_KAT_08",
        .key        = {
            0x00, 0x00, 0x00, 0x00, 0x00, 0x00, 0x00, 0x00, 0x00, 0x00, 0x00, 0x00, 0x00, 0x00, 0x00, 0x00
        },
        .key_len    = 16,
        .iv         = {
            0x00, 0x00, 0x00, 0x00, 0x00, 0x00, 0x00, 0x00, 0x00, 0x00, 0x00, 0x00, 0x00, 0x00, 0x00, 0x00
        },
        .iv_len     = 16,
        .plaintext  = {
            0xF3, 0x44, 0x81, 0xEC, 0x3C, 0xC6, 0x27, 0xBA, 0xCD, 0x5D, 0xC3, 0xFB, 0x08, 0xF2, 0x73, 0xE6
        },
        .pt_len     = 16,
        .ciphertext = {
            0x03, 0x36, 0x76, 0x3E, 0x96, 0x6D, 0x92, 0x59, 0x5A, 0x56, 0x7C, 0xC9, 0xCE, 0x53, 0x7F, 0x5E
        },
        .ct_len     = 16,
        .mode       = AES_CBC,
    },

    /* ── CBC_GFSBOX_128_KAT_09 ── */
    {
        .test_id    = "CBC_GFSBOX_128_KAT_09",
        .key        = {
            0x00, 0x00, 0x00, 0x00, 0x00, 0x00, 0x00, 0x00, 0x00, 0x00, 0x00, 0x00, 0x00, 0x00, 0x00, 0x00
        },
        .key_len    = 16,
        .iv         = {
            0x00, 0x00, 0x00, 0x00, 0x00, 0x00, 0x00, 0x00, 0x00, 0x00, 0x00, 0x00, 0x00, 0x00, 0x00, 0x00
        },
        .iv_len     = 16,
        .plaintext  = {
            0x97, 0x98, 0xC4, 0x64, 0x0B, 0xAD, 0x75, 0xC7, 0xC3, 0x22, 0x7D, 0xB9, 0x10, 0x17, 0x4E, 0x72
        },
        .pt_len     = 16,
        .ciphertext = {
            0xA9, 0xA1, 0x63, 0x1B, 0xF4, 0x99, 0x69, 0x54, 0xEB, 0xC0, 0x93, 0x95, 0x7B, 0x23, 0x45, 0x89
        },
        .ct_len     = 16,
        .mode       = AES_CBC,
    },

    /* ── CBC_GFSBOX_128_KAT_10 ── */
    {
        .test_id    = "CBC_GFSBOX_128_KAT_10",
        .key        = {
            0x00, 0x00, 0x00, 0x00, 0x00, 0x00, 0x00, 0x00, 0x00, 0x00, 0x00, 0x00, 0x00, 0x00, 0x00, 0x00
        },
        .key_len    = 16,
        .iv         = {
            0x00, 0x00, 0x00, 0x00, 0x00, 0x00, 0x00, 0x00, 0x00, 0x00, 0x00, 0x00, 0x00, 0x00, 0x00, 0x00
        },
        .iv_len     = 16,
        .plaintext  = {
            0x96, 0xAB, 0x5C, 0x2F, 0xF6, 0x12, 0xD9, 0xDF, 0xAA, 0xE8, 0xC3, 0x1F, 0x30, 0xC4, 0x21, 0x68
        },
        .pt_len     = 16,
        .ciphertext = {
            0xFF, 0x4F, 0x83, 0x91, 0xA6, 0xA4, 0x0C, 0xA5, 0xB2, 0x5D, 0x23, 0xBE, 0xDD, 0x44, 0xA5, 0x97
        },
        .ct_len     = 16,
        .mode       = AES_CBC,
    },

    /* ── CBC_GFSBOX_128_KAT_11 ── */
    {
        .test_id    = "CBC_GFSBOX_128_KAT_11",
        .key        = {
            0x00, 0x00, 0x00, 0x00, 0x00, 0x00, 0x00, 0x00, 0x00, 0x00, 0x00, 0x00, 0x00, 0x00, 0x00, 0x00
        },
        .key_len    = 16,
        .iv         = {
            0x00, 0x00, 0x00, 0x00, 0x00, 0x00, 0x00, 0x00, 0x00, 0x00, 0x00, 0x00, 0x00, 0x00, 0x00, 0x00
        },
        .iv_len     = 16,
        .plaintext  = {
            0x6A, 0x11, 0x8A, 0x87, 0x45, 0x19, 0xE6, 0x4E, 0x99, 0x63, 0x79, 0x8A, 0x50, 0x3F, 0x1D, 0x35
        },
        .pt_len     = 16,
        .ciphertext = {
            0xDC, 0x43, 0xBE, 0x40, 0xBE, 0x0E, 0x53, 0x71, 0x2F, 0x7E, 0x2B, 0xF5, 0xCA, 0x70, 0x72, 0x09
        },
        .ct_len     = 16,
        .mode       = AES_CBC,
    },

    /* ── CBC_GFSBOX_128_KAT_12 ── */
    {
        .test_id    = "CBC_GFSBOX_128_KAT_12",
        .key        = {
            0x00, 0x00, 0x00, 0x00, 0x00, 0x00, 0x00, 0x00, 0x00, 0x00, 0x00, 0x00, 0x00, 0x00, 0x00, 0x00
        },
        .key_len    = 16,
        .iv         = {
            0x00, 0x00, 0x00, 0x00, 0x00, 0x00, 0x00, 0x00, 0x00, 0x00, 0x00, 0x00, 0x00, 0x00, 0x00, 0x00
        },
        .iv_len     = 16,
        .plaintext  = {
            0xCB, 0x9F, 0xCE, 0xEC, 0x81, 0x28, 0x6C, 0xA3, 0xE9, 0x89, 0xBD, 0x97, 0x9B, 0x0C, 0xB2, 0x84
        },
        .pt_len     = 16,
        .ciphertext = {
            0x92, 0xBE, 0xED, 0xAB, 0x18, 0x95, 0xA9, 0x4F, 0xAA, 0x69, 0xB6, 0x32, 0xE5, 0xCC, 0x47, 0xCE
        },
        .ct_len     = 16,
        .mode       = AES_CBC,
    },

    /* ── CBC_GFSBOX_128_KAT_13 ── */
    {
        .test_id    = "CBC_GFSBOX_128_KAT_13",
        .key        = {
            0x00, 0x00, 0x00, 0x00, 0x00, 0x00, 0x00, 0x00, 0x00, 0x00, 0x00, 0x00, 0x00, 0x00, 0x00, 0x00
        },
        .key_len    = 16,
        .iv         = {
            0x00, 0x00, 0x00, 0x00, 0x00, 0x00, 0x00, 0x00, 0x00, 0x00, 0x00, 0x00, 0x00, 0x00, 0x00, 0x00
        },
        .iv_len     = 16,
        .plaintext  = {
            0xB2, 0x6A, 0xEB, 0x18, 0x74, 0xE4, 0x7C, 0xA8, 0x35, 0x8F, 0xF2, 0x23, 0x78, 0xF0, 0x91, 0x44
        },
        .pt_len     = 16,
        .ciphertext = {
            0x45, 0x92, 0x64, 0xF4, 0x79, 0x8F, 0x6A, 0x78, 0xBA, 0xCB, 0x89, 0xC1, 0x5E, 0xD3, 0xD6, 0x01
        },
        .ct_len     = 16,
        .mode       = AES_CBC,
    },

    /* ── CBC_GFSBOX_128_KAT_14 ── */
    {
        .test_id    = "CBC_GFSBOX_128_KAT_14",
        .key        = {
            0x00, 0x00, 0x00, 0x00, 0x00, 0x00, 0x00, 0x00, 0x00, 0x00, 0x00, 0x00, 0x00, 0x00, 0x00, 0x00
        },
        .key_len    = 16,
        .iv         = {
            0x00, 0x00, 0x00, 0x00, 0x00, 0x00, 0x00, 0x00, 0x00, 0x00, 0x00, 0x00, 0x00, 0x00, 0x00, 0x00
        },
        .iv_len     = 16,
        .plaintext  = {
            0x58, 0xC8, 0xE0, 0x0B, 0x26, 0x31, 0x68, 0x6D, 0x54, 0xEA, 0xB8, 0x4B, 0x91, 0xF0, 0xAC, 0xA1
        },
        .pt_len     = 16,
        .ciphertext = {
            0x08, 0xA4, 0xE2, 0xEF, 0xEC, 0x8A, 0x8E, 0x33, 0x12, 0xCA, 0x74, 0x60, 0xB9, 0x04, 0x0B, 0xBF
        },
        .ct_len     = 16,
        .mode       = AES_CBC,
    },

};

const uint32_t cbc_gfsbox_128_kat_vectors_count = sizeof(cbc_gfsbox_128_kat_vectors) /
                                   sizeof(cbc_gfsbox_128_kat_vectors[0]);

#endif /* AES_128_CBC_GFSBOX_TESTVECTORS_H */
```

## src/aes128_cbc_varkey_06.h
```c
#ifndef AES_128_CBC_VARKEY_TESTVECTORS_06_H
#define AES_128_CBC_VARKEY_TESTVECTORS_06_H

#include <stdint.h>

#define AES_CBC 1


typedef struct {
    const char* test_id;
    uint8_t     key[32];
    uint16_t    key_len;
    uint8_t     iv[16];
    uint16_t    iv_len;
    uint8_t     plaintext[256];
    uint16_t    pt_len;
    uint8_t     ciphertext[256];
    uint16_t    ct_len;
    uint8_t     mode;
} CBC_VarKey_128_KAT_Test_Vectors_06;

/* CBC 128-bit VARKEY — Batch 06 */
static const CBC_VarKey_128_KAT_Test_Vectors_06 cbc_varkey_128_kat_vectors_06[] = {

    /* ── CBC_VARKEY_128_KAT_251 ── */
    {
        .test_id    = "CBC_VARKEY_128_KAT_251",
        .key        = { 0xFF, 0xFF, 0xFF, 0xFF, 0xFF, 0xFF, 0xFF, 0xFF, 0xFF, 0xFF, 0xFF, 0xFF, 0xFF, 0xFF, 0xFF, 0xE0 },
        .key_len    = 16,
        .iv         = { 0x00, 0x00, 0x00, 0x00, 0x00, 0x00, 0x00, 0x00, 0x00, 0x00, 0x00, 0x00, 0x00, 0x00, 0x00, 0x00 },
        .iv_len     = 16,
        .plaintext  = { 0x00, 0x00, 0x00, 0x00, 0x00, 0x00, 0x00, 0x00, 0x00, 0x00, 0x00, 0x00, 0x00, 0x00, 0x00, 0x00 },
        .pt_len     = 16,
        .ciphertext = { 0x25, 0xD6, 0xCF, 0xE6, 0x88, 0x1F, 0x2B, 0xF4, 0x97, 0xDD, 0x14, 0xCD, 0x4D, 0xDF, 0x44, 0x5B },
        .ct_len     = 16,
        .mode       = AES_CBC
    },
    /* ── CBC_VARKEY_128_KAT_252 ── */
    {
        .test_id    = "CBC_VARKEY_128_KAT_252",
        .key        = { 0xFF, 0xFF, 0xFF, 0xFF, 0xFF, 0xFF, 0xFF, 0xFF, 0xFF, 0xFF, 0xFF, 0xFF, 0xFF, 0xFF, 0xFF, 0xF0 },
        .key_len    = 16,
        .iv         = { 0x00, 0x00, 0x00, 0x00, 0x00, 0x00, 0x00, 0x00, 0x00, 0x00, 0x00, 0x00, 0x00, 0x00, 0x00, 0x00 },
        .iv_len     = 16,
        .plaintext  = { 0x00, 0x00, 0x00, 0x00, 0x00, 0x00, 0x00, 0x00, 0x00, 0x00, 0x00, 0x00, 0x00, 0x00, 0x00, 0x00 },
        .pt_len     = 16,
        .ciphertext = { 0x41, 0xC7, 0x8C, 0x13, 0x5E, 0xD9, 0xE9, 0x8C, 0x09, 0x66, 0x40, 0x64, 0x72, 0x65, 0xDA, 0x1E },
        .ct_len     = 16,
        .mode       = AES_CBC
    },
    /* ── CBC_VARKEY_128_KAT_253 ── */
    {
        .test_id    = "CBC_VARKEY_128_KAT_253",
        .key        = { 0xFF, 0xFF, 0xFF, 0xFF, 0xFF, 0xFF, 0xFF, 0xFF, 0xFF, 0xFF, 0xFF, 0xFF, 0xFF, 0xFF, 0xFF, 0xF8 },
        .key_len    = 16,
        .iv         = { 0x00, 0x00, 0x00, 0x00, 0x00, 0x00, 0x00, 0x00, 0x00, 0x00, 0x00, 0x00, 0x00, 0x00, 0x00, 0x00 },
        .iv_len     = 16,
        .plaintext  = { 0x00, 0x00, 0x00, 0x00, 0x00, 0x00, 0x00, 0x00, 0x00, 0x00, 0x00, 0x00, 0x00, 0x00, 0x00, 0x00 },
        .pt_len     = 16,
        .ciphertext = { 0x5A, 0x4D, 0x40, 0x4D, 0x89, 0x17, 0xE3, 0x53, 0xE9, 0x2A, 0x21, 0x07, 0x2C, 0x3B, 0x23, 0x05 },
        .ct_len     = 16,
        .mode       = AES_CBC
    },
    /* ── CBC_VARKEY_128_KAT_254 ── */
    {
        .test_id    = "CBC_VARKEY_128_KAT_254",
        .key        = { 0xFF, 0xFF, 0xFF, 0xFF, 0xFF, 0xFF, 0xFF, 0xFF, 0xFF, 0xFF, 0xFF, 0xFF, 0xFF, 0xFF, 0xFF, 0xFC },
        .key_len    = 16,
        .iv         = { 0x00, 0x00, 0x00, 0x00, 0x00, 0x00, 0x00, 0x00, 0x00, 0x00, 0x00, 0x00, 0x00, 0x00, 0x00, 0x00 },
        .iv_len     = 16,
        .plaintext  = { 0x00, 0x00, 0x00, 0x00, 0x00, 0x00, 0x00, 0x00, 0x00, 0x00, 0x00, 0x00, 0x00, 0x00, 0x00, 0x00 },
        .pt_len     = 16,
        .ciphertext = { 0x02, 0xBC, 0x96, 0x84, 0x6B, 0x3F, 0xDC, 0x71, 0x64, 0x3F, 0x38, 0x4C, 0xD3, 0xCC, 0x3E, 0xAF },
        .ct_len     = 16,
        .mode       = AES_CBC
    },
    /* ── CBC_VARKEY_128_KAT_255 ── */
    {
        .test_id    = "CBC_VARKEY_128_KAT_255",
        .key        = { 0xFF, 0xFF, 0xFF, 0xFF, 0xFF, 0xFF, 0xFF, 0xFF, 0xFF, 0xFF, 0xFF, 0xFF, 0xFF, 0xFF, 0xFF, 0xFE },
        .key_len    = 16,
        .iv         = { 0x00, 0x00, 0x00, 0x00, 0x00, 0x00, 0x00, 0x00, 0x00, 0x00, 0x00, 0x00, 0x00, 0x00, 0x00, 0x00 },
        .iv_len     = 16,
        .plaintext  = { 0x00, 0x00, 0x00, 0x00, 0x00, 0x00, 0x00, 0x00, 0x00, 0x00, 0x00, 0x00, 0x00, 0x00, 0x00, 0x00 },
        .pt_len     = 16,
        .ciphertext = { 0x9B, 0xA4, 0xA9, 0x14, 0x3F, 0x4E, 0x5D, 0x40, 0x48, 0x52, 0x1C, 0x4F, 0x88, 0x77, 0xD8, 0x8E },
        .ct_len     = 16,
        .mode       = AES_CBC
    },
    /* ── CBC_VARKEY_128_KAT_256 ── */
    {
        .test_id    = "CBC_VARKEY_128_KAT_256",
        .key        = { 0xFF, 0xFF, 0xFF, 0xFF, 0xFF, 0xFF, 0xFF, 0xFF, 0xFF, 0xFF, 0xFF, 0xFF, 0xFF, 0xFF, 0xFF, 0xFF },
        .key_len    = 16,
        .iv         = { 0x00, 0x00, 0x00, 0x00, 0x00, 0x00, 0x00, 0x00, 0x00, 0x00, 0x00, 0x00, 0x00, 0x00, 0x00, 0x00 },
        .iv_len     = 16,
        .plaintext  = { 0x00, 0x00, 0x00, 0x00, 0x00, 0x00, 0x00, 0x00, 0x00, 0x00, 0x00, 0x00, 0x00, 0x00, 0x00, 0x00 },
        .pt_len     = 16,
        .ciphertext = { 0xA1, 0xF6, 0x25, 0x8C, 0x87, 0x7D, 0x5F, 0xCD, 0x89, 0x64, 0x48, 0x45, 0x38, 0xBF, 0xC9, 0x2C },
        .ct_len     = 16,
        .mode       = AES_CBC
    },
};

const uint16_t cbc_varkey_128_kat_vectors_06_count = sizeof(cbc_varkey_128_kat_vectors_06) / sizeof(cbc_varkey_128_kat_vectors_06[0]);

#endif /* AES_128_CBC_VARKEY_TESTVECTORS_06_H */
```

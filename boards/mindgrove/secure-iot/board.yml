## boards/mindgrove/secure-iot/board.yml
```yaml
board:
  name: secure-iot
  full_name: secure-iot
  vendor: mindgrove
  socs:
    - name: secure-iot
  revision:
    format: letter
    default: "A"
    revisions:
      - name: "A"
```

## boards/mindgrove/vision-soc/Kconfig.vision-soc
```kconfig
config BOARD_VISION_SOC
	bool "Vision SoC target"
        select SOC_FAMILY_MINDGROVE
	select SOC_VISION_SOC
        select HAS_DTS
        select RISCV_HAS_FPU
        select CPU_HAS_FPU
```

## boards/mindgrove/vision-soc/board.yml
```yaml
board:
  name: vision-soc
  full_name: Vision_SoC
  vendor: mindgrove
  socs:
    - name: vision-soc
  revision:
    format: letter
    default: "A"
    revisions:
      - name: "A"
```

## boards/mindgrove/vision-soc/vision-soc_defconfig
```kconfig
CONFIG_CONSOLE=y
CONFIG_EARLY_CONSOLE=y
CONFIG_STDOUT_CONSOLE=y
CONFIG_PRINTK=y
CONFIG_SERIAL=y
CONFIG_UART_MINDGROVE=y
CONFIG_UART_MINDGROVE_PORT=y
CONFIG_UART_CONSOLE=y
CONFIG_BOOT_BANNER=y
CONFIG_SRAM_BASE_ADDRESS=0x80000000
CONFIG_SRAM_SIZE=1024
CONFIG_TIMING_FUNCTIONS=y
CONFIG_FPU=y
CONFIG_OUTPUT_DISASSEMBLY=y
CONFIG_OUTPUT_DISASSEMBLE_ALL=y
```

## boards/riscv/secure-iot/secure-iot_defconfig
```kconfig
CONFIG_SOC_SERIES_RISCV64_SHAKTI=y
CONFIG_SOC_RISCV64_SHAKTI=y
CONFIG_BOARD_SECURE_IOT=y
CONFIG_CONSOLE=y
CONFIG_PRINTK=y
CONFIG_SERIAL=y
CONFIG_UART_MINDGROVE=y
# CONFIG_UART_INTERRUPT_DRIVEN=y
CONFIG_UART_MINDGROVE_PORT=y
# CONFIG_UART_SHAKTI_PORT_1=y
CONFIG_UART_CONSOLE=y
CONFIG_XIP=n
CONFIG_RISCV_MACHINE_TIMER=y
CONFIG_PLIC=y
CONFIG_SRAM_BASE_ADDRESS=0x80000000
CONFIG_SRAM_SIZE=256000
CONFIG_STDOUT_CONSOLE=y
CONFIG_TIMING_FUNCTIONS=y
CONFIG_FPU=y
CONFIG_MULTITHREADING=n
CONFIG_BOOT_BANNER=y
CONFIG_MINDGROVE_PLIC=y
CONFIG_RISCV_HAS_PLIC=y
# Below 2 configs for FPGA 40MHZ clk
CONFIG_SYS_CLOCK_HW_CYCLES_PER_SEC=156250
CONFIG_SYS_CLOCK_TICKS_PER_SEC=10000
CONFIG_ISR_STACK_SIZE=4096
# Below 2 configs for FPGA 700MHZ clk
# CONFIG_SYS_CLOCK_HW_CYCLES_PER_SEC=156250
# CONFIG_SYS_CLOCK_TICKS_PER_SEC=10000


# CONFIG_MINIMAL_LIBC_RAND=y
# CONFIG_POSIX_CLOCK=y
# CONFIG_MINIMAL_LIBC_RAND=y
CONFIG_POSIX_CLOCK=y
CONFIG_OUTPUT_DISASSEMBLY=y
CONFIG_OUTPUT_DISASSEMBLE_ALL=y
```

## boards/riscv/vision-soc/Kconfig.board
```kconfig
config BOARD_VISION_SOC
	bool "Vision SoC target"
	depends on SOC_RISCV64_SHAKTI
        select HAS_DTS
        select RISCV_HAS_FPU
        select CPU_HAS_FPU
```

## boards/riscv/vision-soc/vision-soc_defconfig
```kconfig
CONFIG_SOC_SERIES_RISCV64_SHAKTI=y
CONFIG_SOC_RISCV64_SHAKTI=y
CONFIG_BOARD_VISION_SOC=y
CONFIG_CONSOLE=y
CONFIG_PRINTK=y
CONFIG_SERIAL=y
CONFIG_UART_SHAKTI=y
CONFIG_UART_SHAKTI_PORT_0=y
CONFIG_UART_CONSOLE=y
CONFIG_XIP=n
CONFIG_BOOT_BANNER=y
CONFIG_SRAM_BASE_ADDRESS=0x80000000
CONFIG_SRAM_SIZE=1024
CONFIG_RAM_CONSOLE=y
CONFIG_TIMING_FUNCTIONS=y
CONFIG_FPU=y

# CONFIG_SHAKTI_PLIC=y
CONFIG_RISCV_HAS_PLIC=y
# CONFIG_PLIC=y
# Below 2 configs for FPGA 40MHZ clk
# CONFIG_SYS_CLOCK_HW_CYCLES_PER_SEC=156250
# CONFIG_SYS_CLOCK_TICKS_PER_SEC=10000

# Below 2 configs for FPGA 700MHZ clk
# CONFIG_SYS_CLOCK_HW_CYCLES_PER_SEC=156250
# CONFIG_SYS_CLOCK_TICKS_PER_SEC=10000


CONFIG_MINIMAL_LIBC_RAND=y
CONFIG_POSIX_CLOCK=y

CONFIG_OUTPUT_DISASSEMBLY=y
CONFIG_OUTPUT_DISASSEMBLE_ALL=y
```

## drivers/flash/Kconfig.secureiot
```kconfig
# SPDX-License-Identifier: Apache-2.0

menuconfig SECUREIOT_FLASH
    bool "SecureIoT flash driver"
    default y
	help
	  This option enables the SecureIoT flash driver.

config FLASH_INIT_PRIORITY
    int "Flash init priority"
	default KERNEL_INIT_PRIORITY_DEFAULT
	help
	  Flash driver device initialization priority.
```

## drivers/interrupt_controller/Kconfig.mindgrove_plic
```kconfig
# Need to do changes suitable for Mindgrove's plic
# Copyright (c) 2025 Mindgrove Technologies Private Limited.
# SPDX-License-Identifier: Apache-2.0

config MINDGROVE_PLIC
	bool "Platform Level Interrupt Controller (PLIC)"
	default y
	help
	  Platform Level Interrupt Controller provides support
	  for external interrupt lines defined by the RISC-V SoC.
```

## drivers/pwm/Kconfig.seciot
```kconfig
# seciot Freedom PWM configuration options

# Copyright (c) 2018 seciot Inc.
# SPDX-License-Identifier: Apache-2.0

config PWM_SECIOT
	bool "Mindgrove Silicon Secure-iot-SoC PWM driver"
	default y
	help
	  Enable the PWM driver for the seciot Freedom platform
```

## drivers/serial/Kconfig.mindgrove
```kconfig
# Kconfig.fe310 - SiFive Freedom UART configuration option
#
# Copyright (c) 2017 Jean-Paul Etienne <fractalclone@gmail.com>
#
# SPDX-License-Identifier: Apache-2.0
#

menuconfig UART_MINDGROVE
	bool "Mindgrove serial driver"
	depends on SOC_FAMILY_MINDGROVE
	select SERIAL_HAS_DRIVER
	select SERIAL_SUPPORT_INTERRUPT
	help
	  This option enables the Mindgrove serial driver.

# ---------- Port 0 ----------

menuconfig UART_MINDGROVE_PORT
	bool "Enable Mindgrove UART Ports"
	depends on UART_MINDGROVE
	help
	  This tells the driver to configure the UART port at boot, depending on
	  the additional configure options below.

config UART_MINDGROVE_PORT_IRQ_PRIORITY
	int "Mindgrove UART Interrupt Priority"
	default 1
	depends on UART_MINDGROVE_PORT
	help
	  Mindgrove UART Interrupt Priority

config UART_MINDGROVE_PORT_RXCNT_IRQ
	int "Mindgrove UART RX Interrupt Threshold Count"
	default 0
	depends on UART_MINDGROVE_PORT
	help
	  Mindgrove UART RX Threshold at which the RX FIFO interrupt triggers.

config UART_MINDGROVE_PORT_TXCNT_IRQ
	int "Mindgrove UART TX Interrupt Threshold Count"
	default 0
	depends on UART_MINDGROVE_PORT
	help
	  Mindgrove UART TX Threshold at which the TX FIFO interrupt triggers.
```

## drivers/spi/Kconfig.mindgrove
```kconfig
# Mindgrove SPI Driver configuration options

# Copyright (c) 2025 Mindgrove Technologies Private Limited.
# SPDX-License-Identifier: Apache-2.0

config SPI_MINDGROVE
	bool "Mindgrove SPI controller driver"
	default y
	help
	  This option enables the Mindgrove spi driver.

config SPI_INIT_PRIORITY
	int "SPI init priority"
	default KERNEL_INIT_PRIORITY_DEFAULT
	help
	  SPI driver device initialization priority.
```

## drivers/spi/Kconfig.seciot
```kconfig
# seciot SPI Driver configuration options

# Copyright (c) 2024 seciot Inc.
# SPDX-License-Identifier: Apache-2.0

config SPI_SECIOT
	bool "seciot SPI controller driver"
	default y
	help
	  This option enables the seciot spi driver.

config SPI_INIT_PRIORITY
	int "SPI init priority"
	default KERNEL_INIT_PRIORITY_DEFAULT
	help
	  SPI driver device initialization priority.
```

## drivers/watchdog/Kconfig.seciot
```kconfig
# SiFive Freedom WDT configuration

# Copyright (C) 2020 Katsuhiro Suzuki
# SPDX-License-Identifier: Apache-2.0

config WDT_SECIOT
	bool "SiFive Watchdog (WDT) Driver"
	default y
	help
	  This option enables WDT driver for SiFive Freedom.
```

## dts/bindings/flash_controller/secureiot,flash-controller.yaml
```yaml
# Copyright (c) 2018, SiFive Inc.
# SPDX-License-Identifier: Apache-2.0

description: |
  Flash QSPI controller.

compatible: "secureiot,flash-controller"

properties:
  reg:
    type: array
    required: true
```

## dts/bindings/i2c/mindgrove,i2c.yaml
```yaml
# Copyright (c) 2025 Mindgrove Technologies Pvt. Ltd 
# SPDX-License-Identifier: Apache-2.0

description: Mindgrove Silicon Secure-IoT I2C interface

compatible: "mindgrove,i2c"

properties:
  reg:
    type: array
    required: true

  clock_frequency:
    type: int
    required: true

  scl_frequency:
    type: int
    required: true
  
  base:
    type: int
    required: true
  
```

## dts/bindings/interrupt-controller/mindgrove,plic0.yaml
```yaml
# Copyright (c) 2018, SiFive Inc.
# SPDX-License-Identifier: Apache-2.0

description: Mindgrove RISCV-V platform-local interrupt controller

compatible: "mindgrove,plic0"

include: riscv,plic0.yaml

properties:
  riscv,ndev:
    type: int
    description: Number of external interrupts supported
    required: true
  base:
    type: int
    required: true   
  interrupt-shift:
    type: int
    required: false
```

## dts/bindings/serial/mindgrove,uart0.yaml
```yaml
#
# Copyright (c) 2018, SiFive Inc.
#
# SPDX-License-Identifier: Apache-2.0

description: >
    This binding gives a base representation of the mindgrove UART

compatible: "mindgrove,uart0"

include: [uart-controller.yaml]

properties:
    reg:
      required: true

    interrupts:
      required: false
```

## dts/bindings/spi/shakti,spi.yaml
```yaml
# Copyright (c) 2018, SiFive Inc.
# SPDX-License-Identifier: Apache-2.0

description: |
  shakti SPI controller.

  Note: First instance of the Sifive SPI controller (spi0) must be kept
  disabled if used to access SPI Flash ROM. Failing to do so could result in
  crashes during boot time.

compatible: "shakti,spi"

properties:
  reg:
    type: array
    required: true

  sclk_configure:
    type: array
    required: true

  comm_configure:
    type: array
    required: true

  clock-frequency:
    type: int
    required: true

compatible: "ili9341"
propeties:
  spi-max-frequency:
    type: int
    required: true 
  
  reg:
    type: int
    required: true
  
  cs-gpios:
    type: phandle-array
    required: true

  cmd-data-gpios:
    type: phandle-array
    required: true      
  
  width:
    type: int
    required: true

  height:
    type: int
    required: true

  rotation:
    type: int
    required: true

  pixel-format:
    type: int
    required: true

  pwctrla:
    type: array
    required: true

  pwctrlb:
    type: array
    required: true

  timctrla:
    type: array
    required: true

  timctrlb:
    type: array
    required: true

  pwseqctrl:
    type: array
    required: true

  pumpratioctrl:
    type: array
    required: true

  disctrl:
    type: array
    required: true

  vmctrl1:
    type: array
    required: true

  vmctrl2:
    type: array
    required: true

  enable3g:
    type: array
    required: true

  ifctl:
    type: array
    required: true

  ifmode:
    type: array
    required: true

  gamset:
    type: array
    required: true

  frmctr1:
    type: array
    required: true

  pwctrl1:
    type: array
    required: true

  pwctrl2:
    type: array
    required: true

  pgamctrl:
    type: array
    required: true

  ngamctrl:
    type: array
    required: true
```

## dts/bindings/watchdog/seciot,wdt.yaml
```yaml
# Copyright (c) 2018, SiFive Inc.
# SPDX-License-Identifier: Apache-2.0

description: |
  seciot Watchdog timer.

  Note: First instance of the Sifive SPI controller (spi0) must be kept
  disabled if used to access SPI Flash ROM. Failing to do so could result in
  crashes during boot time.

compatible: "seciot,wdt"

properties:
  reg:
    type: array
    required: true
  
  rcycles:
    type: int
    required: true
    
  wcycles:
    type: int
    required: true
  
```

## soc/mindgrove/Kconfig
```kconfig
#
# Copyright 2025 Mindgrove Technologies
#
# SPDX-License-Identifier: Apache-2.0
#

if SOC_FAMILY_MINDGROVE

rsource "*/Kconfig"

endif # SOC_FAMILY_MINDGROVE
```

## soc/mindgrove/Kconfig.defconfig
```kconfig
#
# Copyright 2021 Huawei France Technologies SASU
#
# SPDX-License-Identifier: Apache-2.0
#

if SOC_FAMILY_MINDGROVE

rsource "*/Kconfig.defconfig"

endif
```

## soc/mindgrove/Kconfig.soc
```kconfig
#
# Copyright 2021 Huawei France Technologies SASU
#
# SPDX-License-Identifier: Apache-2.0
#

config SOC_FAMILY_MINDGROVE
	bool

config SOC_FAMILY
	default "mindgrove" if SOC_FAMILY_MINDGROVE

rsource "*/Kconfig.soc"
```

## soc/mindgrove/secure-iot/Kconfig
```kconfig
# Kconfig - RISCV64 SHAKTI-VAJRA SOC configuration options
#
# SPDX-License-Identifier: Apache-2.0
#

config SOC_SECURE_IOT
	bool

	# RISC-V options
	select RISCV
	select RISCV_PRIVILEGED
	select RISCV_HAS_PLIC
	select RISCV_PMP
	select RISCV_SOC_HAS_GP_RELATIVE_ADDRESSING
	select CPU_HAS_FPU
	select ARCH_HAS_DIRECTED_IPIS

	select RISCV_ISA_RV64I
	select RISCV_ISA_EXT_M
	select RISCV_ISA_EXT_A
	select RISCV_ISA_EXT_C
	select RISCV_ISA_EXT_ZICSR
	select RISCV_ISA_EXT_ZIFENCEI

	select INCLUDE_RESET_VECTOR
	# select SOC_EARLY_INIT_HOOK
	# imply XIP
```

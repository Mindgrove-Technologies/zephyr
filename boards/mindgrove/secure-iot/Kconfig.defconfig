## boards/mindgrove/secure-iot/Kconfig.defconfig
```kconfig
if BOARD_SECURE_IOT

config BOARD
	default "Secure IoT"

config RISCV_HAS_CLIC
    default n

# Increase total IRQ table size
config NUM_IRQS
    int
    default 160

endif
```

## boards/mindgrove/secure-iot/Kconfig.secure-iot
```kconfig
config BOARD_SECURE_IOT
	bool "Secure IoT target"
        select SOC_SECURE_IOT
        select HAS_DTS
        select RISCV_HAS_FPU
        select CPU_HAS_FPU

config RISCV_CORE_NUM_IRQS
    int
    default 16
    help
      Defines the number of IRQs in the CPU's primary interrupt vector table.
      Must be large enough to include the MEIP (IRQ 11) for the PLIC.
```

## drivers/counter/Kconfig.mindgrove
```kconfig
menuconfig COUNTER_MINDGROVE
    bool "Mindgrove General Purpose Timer (GPTIMER) driver"
    default y
    depends on DT_HAS_MINDGROVE_GPTIMER_ENABLED && COUNTER
    help
      Enable support for the Mindgrove General Purpose Timer (GPTIMER).
      This driver provides a standard Zephyr Counter API interface 
      for the hardware's 4 timer instances.

if COUNTER_MINDGROVE

config COUNTER_MINDGROVE_INIT_PRIORITY
    int "Initialization priority"
    default 60
    help
      Timer initialization priority. This should be higher (lower number)
      than any application code that uses the timer, but lower than 
      the interrupt controller (PLIC) initialization.

endif # COUNTER_MINDGROVE
```

## drivers/crypto/KConfig.mindgrove
```kconfig
# Mindgrove AES driver

config CRYPTO_MINDGROVE_AES
	bool "Mindgrove AES hardware accelerator"
	depends on CRYPTO
	depends on HAS_DTS
	help
	  Enable the Mindgrove hardware AES accelerator driver.

	  Features:
	  - AES-128 / AES-192 / AES-256
	  - ECB, CBC, CFB, OFB, CTR modes
	  - Polling-based synchronous operation
	  - Thread-safe via mutex

	  Limitations:
	  - No async support
	  - No PSA Crypto integration
	  - No secure key storage
```

## drivers/crypto/Kconfig.mindgrove
```kconfig
# MindGrove AES driver
config CRYPTO_MINDGROVE_AES
    bool "MindGrove AES hardware accelerator"
    depends on CRYPTO
    help
      Enable the MindGrove hardware AES accelerator driver.

# Enable the MindGrove SHA driver
config ENABLE_MINDGROVE
    bool "Enable MindGrove SHA driver"
    default y
    help
      Enable the MindGrove SHA-256 hardware accelerator driver.

if ENABLE_MINDGROVE

config CRYPTO_MINDGROVE_SHA256
    bool "MindGrove SHA-256 hardware accelerator"
    depends on CRYPTO
    help
      Enable MindGrove SHA-256 hardware accelerator driver.

config MINDGROVE_SHA_MAX_SESSIONS
    int "Maximum number of concurrent SHA sessions"
    depends on CRYPTO_MINDGROVE_SHA256
    default 4
    range 1 16

config MINDGROVE_SHA_INIT_PRIORITY
    int "SHA driver initialization priority"
    depends on CRYPTO_MINDGROVE_SHA256
    default 70
    range 0 99

config CRYPTO_MINDGROVE_RSA
    bool "Mindgrove RSA 2048 Hardware Accelerator"
    depends on CRYPTO
    depends on DT_HAS_MINDGROVE_RSA2048_ENABLED
    select CRYPTO_MINDGROVE_SHA256
    select MBEDTLS
    select MBEDTLS_RSA_C
    select MBEDTLS_PKCS1_V15
    help
      Enable support for the Mindgrove RSA hardware accelerator.
      This driver supports RSA-2048 operations with PKCS, PSS, and OAEP padding.
      Automatically enables mbedTLS bignum for R² mod N precomputation.

endif # ENABLE_MINDGROVE
```

## drivers/dma/Kconfig.mindgrove
```kconfig
config DMA_MINDGROVE
    bool "MINDGROVE DMA driver"
    default y
    depends on DT_HAS_MINDGROVE_DMA_ENABLED
    select DMA_HAS_CONTEXT # Required for struct dma_context usage
    help
      Enable support for the Mindgrove Custom SoC DMA controller.
```

## drivers/entropy/Kconfig.mindgrove
```kconfig
config ENTROPY_MINDGROVE_TRNG
    bool "Mindgrove TRNG driver"
    default y
    depends on DT_HAS_MINDGROVE_TRNG_ENABLED
    select ENTROPY_HAS_DRIVER
    help
      Enable support for the Mindgrove True Random Number Generator.
```

## drivers/flash/Kconfig.mindgrove
```kconfig
# Mindgrove QSPI Flash Driver Configuration

menuconfig FLASH_MINDGROVE
	bool "Mindgrove QSPI Flash Driver"
	default y
	depends on DT_HAS_MINDGROVE_QSPI_FLASH_ENABLED
	select FLASH_HAS_DRIVER_ENABLED
	# Note: Un-comment the line below only after you implement flash_get_page_layout
	# select FLASH_HAS_PAGE_LAYOUT 
	help
	  Enable the Mindgrove QSPI flash driver for Secure IoT SoC.

if FLASH_MINDGROVE

config FLASH_MINDGROVE_XIP_SUPPORT
	bool "Enable Execute-In-Place (XIP) Support"
	default y
	help
	  Configures the QSPI controller for memory-mapped read access.
	  This allows the CPU to execute code directly from flash.
	  Note: Write/Erase operations may require special handling (RAM functions)
	  if XIP is active.

config FLASH_MINDGROVE_POLL_TIMEOUT
	int "Status Poll Timeout (ms)"
	default 1000
	help
	  Maximum time to wait for the WIP (Write In Progress) bit to clear.
	  Increase this if you plan on performing Chip Erase operations.

config FLASH_MINDGROVE_INIT_PRIORITY
	int "Driver Initialization Priority"
	default FLASH_INIT_PRIORITY
	help
	  Initialization priority for the Mindgrove QSPI flash driver.
	  Defaults to the standard Zephyr flash priority (typically 40 or 80).

endif # FLASH_MINDGROVE
```

## drivers/gpio/Kconfig.mindgrove
```kconfig
# SiFive Freedom GPIO configuration option

# Copyright (c) 2017 Jean-Paul Etienne <fractalclone@gmail.com>
# SPDX-License-Identifier: Apache-2.0

menuconfig GPIO_MINDGROVE
	bool "mindgrove GPIO driver"
	default y
	help
	  This option enables the Mindgrove GPIO driver.

config GPIO_INIT_PRIORITY
	int "GPIO init priority"
	default KERNEL_INIT_PRIORITY_DEFAULT
	help
	  GPIO driver device initialization priority.

config GPIO_MINDGROVE_AUTO_IRQ_CONNECT
    bool "Automatically connect GPIO IRQs in the driver"
    default y
    help
      If enabled the GPIO driver will call IRQ_CONNECT during init to
      register the controller IRQ for each instance.  If disabled the
      application/board is expected to register IRQ handlers directly
      (e.g. with IRQ_DIRECT_CONNECT) for low-latency use-cases.
```

## drivers/interrupt_controller/Kconfig.mindgrove
```kconfig
# Need to do changes suitable for shakti's plic


# Copyright (c) 2022 Carlo Caione <ccaione@baylibre.com>
# SPDX-License-Identifier: Apache-2.0

config MINDGROVE_PLIC
	bool "Platform Level Interrupt Controller (PLIC)"
	help
	  Platform Level Interrupt Controller provides support
	  for external interrupt lines defined by the RISC-V SoC.

config PLIC_MEIP_PRIORITY
    int "Priority for the Machine External Interrupt (MEIP)"
    default 3
    range 1 7 # Or whatever the supported range is for your PLIC
    help
      This sets the priority for the PLIC's interrupt in the CPU's local
      interrupt controller (CLINT/LINTC).
```

## drivers/memc/Kconfig.mindgrove
```kconfig
config MEMC_MINDGROVE_PSRAM
    bool "MINDGROVE QSPI PSRAM driver"
    default y
    depends on DT_HAS_MINDGROVE_QSPI_PSRAM_ENABLED
    help
      Enable the MINDGROVE QSPI PSRAM driver for Secure IoT SoC.
      Initializes PSRAM into quad memory-mapped mode on boot.

if MEMC_MINDGROVE_PSRAM

config MEMC_MINDGROVE_PSRAM_INIT_PRIORITY
    int "PSRAM initialization priority"
    default 85
    help
      Initialization priority for the MINDGROVE PSRAM driver.
      Must be higher than flash init priority so flash initializes first.

endif # MEMC_MINDGROVE_PSRAM
```

## drivers/pinctrl/Kconfig.mindgrove
```kconfig
# Copyright (c) 2024 Mindgrove Technologies
# SPDX-License-Identifier: Apache-2.0

config PINCTRL_MINDGROVE
	bool "Mindgrove pinctrl driver"
	default y if DT_HAS_MINDGROVE_PINCTRL_ENABLED
	depends on PINCTRL
	help
	  Enable pinctrl driver for Mindgrove SoC platform.

config PINCTRL_INIT_PRIORITY
	int "Pinctrl initialization priority"
	default 45
	depends on PINCTRL
	help
	  Initialization priority for the pinctrl driver.
```

## drivers/pwm/Kconfig.mindgrove
```kconfig
# Copyright (c) 2025 Mindgrove Technologies Private Limited.
# SPDX-License-Identifier: Apache-2.0

config PWM_MINDGROVE
	bool "Mindgrove PWM driver"
	default y
  depends on PWM
	help
	  This option enables Mindgrove PWM Driver for secure_iot

config PWM_CLOCK_FREQUENCY
    int "PWM clock frequency"
    default 700000000
    depends on PWM_MINDGROVE
    help
      This option sets the input clock frequency for the PWM peripheral.
```

## drivers/watchdog/Kconfig.mindgrove
```kconfig
# Copyright (c) 2025 Mindgrove Technologies Private Limited.
# SPDX-License-Identifier: Apache-2.0

config WDT_MINDGROVE
	bool "Mindgrove Watchdog Timer (WDT) driver"
	default y
	select HAS_DTS_WDT
	help
	  Enable the Watchdog Timer (WDT) driver for Mindgrove SoCs.
```

## dts/bindings/counter/mindgrove,gptimer.yaml
```yaml
# dts/bindings/mindgrove,gptimer.yaml
description: Mindgrove GPTimer

compatible: "mindgrove,gptimer"

include: base.yaml

properties:
  reg:
    required: true

  interrupts:
    required: true

  clock-frequency:
    type: int
    required: true
    description: Timer input clock frequency in Hz

  prescaler:
    type: int
    required: true
    description: Clock prescaler divider value
  timer-mode:
    type: int
    required: true
    description: "1=UP count, 2=DOWN count"
```

## dts/bindings/crypto/mindgrove,sha.yaml
```yaml
# Copyright (c) 2025 Mindgrove
# SPDX-License-Identifier: Apache-2.0

description: |
  Mindgrove SHA-256 hardware accelerator.
  Supports SHA-256 hashing only.
  Polling-based, synchronous operation.

compatible: "mindgrove,sha256"

include: base.yaml

properties:
  reg:
    required: true
    description: |
      Memory-mapped register region for the SHA-256 hardware engine.

  interrupts:
    required: false
    description: |
      Not used. SHA driver operates in polling mode only.

required:
  - reg
```

## dts/bindings/crypto/mindgrove-aes.yaml
```yaml
# Copyright (c) 2025 Mindgrove
# SPDX-License-Identifier: Apache-2.0

description: |
  Mindgrove hardware AES accelerator.
  Supports AES-128/192/256 in ECB, CBC, CFB, OFB and CTR modes.
  Polling-based, synchronous operation only.

compatible: "mindgrove-aes"

include: base.yaml

properties:
  reg:
    required: true
    description: |
      Memory-mapped register space for the AES hardware engine.

  interrupts:
    required: false
    description: |
      Not used. AES driver operates in polling mode only.
```

## dts/bindings/crypto/mindgrove_rsa.yaml
```yaml
description: Mindgrove RSA 2048 Hardware Accelerator

compatible: "mindgrove,rsa2048"

include: base.yaml

properties:
  reg:
    required: true
  interrupts:
    required: false
  status:
    required: true
```

## dts/bindings/crypto/mindgrove_sha256.yaml
```yaml
# dts/bindings/crypto/mindgrove,sha256.yaml
description: MindGrove SHA-256 Hardware Accelerator

compatible: "mindgrove,sha256"

include: [base.yaml]

properties:
  reg:
    required: true
    description: Register address and size

  status:
    required: false
```

## dts/bindings/dma/mindgrove,dma.yaml
```yaml
description: Mindgrove Custom SoC DMA controller
compatible: "mindgrove,dma"

include: [dma-controller.yaml, base.yaml] # Added base.yaml for standard props

properties:
    reg:
      required: true
    "#dma-cells":
      const: 1
    # Add this to define the interrupt structure
    interrupts:
      required: true
```

## dts/bindings/entropy/mindgrove,trng.yaml
```yaml
# mindgrove,trng.yaml
description: Mindgrove True Random Number Generator (TRNG)

compatible: "mindgrove,trng"

include: base.yaml

properties:
  reg:
    required: true
    description: Base address and size of the TRNG register block.

  instance-id:
    type: int
    required: true
    enum: [0, 1]
    description: Hardware instance index (0 or 1).
```

## dts/bindings/flash_controller/mindgrove,flash-controller.yaml
```yaml
description: Mindgrove QSPI Flash Controller and JEDEC Flash

compatible: "mindgrove,qspi-flash"

include: [base.yaml, flash-controller.yaml]

properties:
  reg:
    required: true
    description: Mapping for the QSPI controller registers.

  # JEDEC/Flash specific properties
  size:
    type: int
    description: Total flash capacity in bits.

  jedec-id:
    type: uint8-array
    description: |
      JEDEC ID as defined in the manufacturer datasheet.
      Example: [ef 40 18] for Winbond W25Q128.

  # Custom Controller properties
  dummy-cycles:
    type: int
    default: 4
    description: Number of dummy clock cycles for fast read.

  max-frequency:
    type: int
    description: Maximum QSPI bus frequency in Hz.
```

## dts/bindings/gpio/mindgrove,gpio.yaml
```yaml
# Copyright (c) 2018, SiFive Inc.
# SPDX-License-Identifier: Apache-2.0

description: Mindgrove GPIO node

compatible: "mindgrove,gpio"

include: [gpio-controller.yaml, base.yaml]

properties:
  interrupts:
    type: array
    required: true
  
  interrupt-names:
    type: string-array
    required: false

  "#gpio-cells":
    type: int
    # const: 2

  config_gpio:
    type: int
    required: true  

  gpio-controller:
    type: boolean
    description: Identifies a node as a GPIO controller.

gpio-cells:
  - pin
  - flags
```

## dts/bindings/interrupt-controller/mindgrove,plic.yaml
```yaml
# Copyright (c) 2018, SiFive Inc.
# SPDX-License-Identifier: Apache-2.0

description: Mindgrove RISC-V PLIC

compatible: "mindgrove,plic"

include: riscv,plic0.yaml

properties:
  compatible:
    type: string-array
    required: true

  reg:
    type: array
    required: true
    description: PLIC register space
  
  "interrupt-controller":
    type: boolean
    required: true
    description: Convey's this node is an interrupt controller

  "#interrupt-cells":
    type: int
    const: 2
    required: true

  '#address-cells':
    type: int
    required: true
    const: 0
    description: Number of cells to encode a target address

  riscv,max-priority:
    type: int
    required: true
    description: Maximum interrupt priority
  
  riscv,ndev:
    type: int
    description: Number of external interrupts supported
    required: false

  # interrupts-extended:
  #   type: phandle-array
  #   required: false
  #   description: Extended interrupt specifiers
  riscv-irq-aggregator-offset:
    type: int
    required: true
    description: |
        The offset into the system's software interrupt table 
        where this aggregator's interrupt table starts. Must be 0 
        for the first (and typically only) PLIC instance.

interrupt-cells:
  - irq
  - priority
  
```

## dts/bindings/memory-controllers/mindgrove,qspi-psram.yaml
```yaml
description: MINDGROVE QSPI PSRAM

compatible: "mindgrove,qspi-psram"

include: [base.yaml]

properties:
  reg:
    required: true
    description: Base address and size of QSPI controller registers

  size:
    type: int
    required: true
    description: PSRAM size in bytes
```

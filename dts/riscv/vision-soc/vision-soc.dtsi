/dts-v1/;

#include <riscv64-vision-soc.dtsi>

/ {
	model = "mindgrove,visionsoc";
	compatible = "mindgrove,visionsoc-dev";

chosen {
		zephyr,console = &uart0;
	};


};

&uart0 {
	status = "ok";
	current-speed = <115200>;
	clock-frequency = <1000000000>;
};

## dts/bindings/pinctrl/mindgrove,pinctrl.yaml
```yaml
description: Mindgrove pin controller
compatible: "mindgrove,pinctrl"
include: base.yaml

properties:
  reg:
    required: true

child-binding:
  description: Pin configuration state node
  properties:
    pinmux:
      type: array
      required: true
      description: Array of pin configuration words encoded with MINDGROVE_PINMUX()
```

## dts/bindings/pwm/mindgrove,pwm.yaml
```yaml
# Copyright (c) 2025 Mindgrove Technologies Private Limited.
# SPDX-License-Identifier: Apache-2.0

description: |
  Mindgrove PWM controller.

include:
  - name: pinctrl-device.yaml

compatible: "mindgrove,pwm"

properties:
  reg:
    type: array
    required: true

  db_configure:
    type: array
    required: true

  clock-frequency:
    type: int
    required: true
    description: Clock frequency of the PWM peripheral in Hz
```

## dts/bindings/serial/mindgrove,uart.yaml
```yaml
# Copyright (c) 2025, Mindgrove Technologies.
# SPDX-License-Identifier: Apache-2.0

description: >
  This binding gives a base representation of the Mindgrove UART

compatible: "mindgrove,uart"

include:
  - name: uart-controller.yaml
  - name: pinctrl-device.yaml

properties:
  reg:
    required: true
  interrupts:
    required: true
  clock-frequency:
    required: true
  current-speed:
    required: true
  reg-io-width:
    type: int
    required: false
    description: |
      Specify the register access width in bytes (1, 2, or 4).
      Must match the CPU's memory access width for the peripheral bus.
      Defaults to 1 byte (8-bit) if not specified.
    enum:
      - 1
      - 2
      - 4
```

## dts/bindings/spi/mindgrove,spi.yaml
```yaml
# Copyright (c) 2025 Mindgrove Technologies Private Limited.
# SPDX-License-Identifier: Apache-2.0
description: |
  Mindgrove SPI controller.

compatible: "mindgrove,spi"

include:
  - name: spi-controller.yaml
  - name: pinctrl-device.yaml

properties:
  reg:
    type: array
    required: true
  sclk_configure:
    type: array
    required: false
  comm_configure:
    type: array
    required: false
  clock-frequency:
    type: int
    required: true
  cs-gpios:
    required: false
```

## dts/bindings/watchdog/mindgrove,wdt.yaml
```yaml
# SPDX-License-Identifier: Apache-2.0

description: Mindgrove Watchdog Timer (WDT)

compatible: "mindgrove,wdt"

include: base.yaml

properties:
  clock-frequency:
    type: int
    required: true
    description: Watchdog input clock frequency in Hz.
```

## samples/aes/sample.yaml
```yaml
sample:
  description: AES sample
    application
  name: aes
common:
  tags: introduction
  integration_platforms:
    - native_posix
  harness: console
  harness_config:
    type: one_line
    regex:
      - "AES SAMPLE"
tests:
  sample.basic.helloworld:
    tags: introduction
```

## soc/mindgrove/secure-iot/Kconfig.soc
```kconfig
# Kconfig - RISCV64 SHAKTI VAJRA SOC implementation
#
# SPDX-License-Identifier: Apache-2.0
#

config SOC_SECURE_IOT
	bool "Mindgrove SECURE IOT implementation"
	select RISCV
	select 64BIT
	select SOC_FAMILY_MINDGROVE
  select MULTI_LEVEL_INTERRUPTS
  select GEN_SW_ISR_TABLE
  select INTC_SINGLE_AGGREGATOR

config RISCV_CORE_NUM_IRQS
    int
    default 16
    help
      Defines the number of IRQs in the CPU's primary interrupt vector table.
      Must be large enough to include the MEIP (IRQ 11) for the PLIC.	
```

## tests/subsys/random/rng/boards/secure-iot.conf
```kconfig
CONFIG_UART_MINDGROVE=y
CONFIG_CONSOLE=y
CONFIG_UART_CONSOLE=y
CONFIG_MULTITHREADING=y
CONFIG_PRINTK=y
CONFIG_ENTROPY_MINDGROVE=y
CONFIG_TEST_RANDOM_GENERATOR=n
```

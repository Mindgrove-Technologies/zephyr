## prj.conf
```kconfig
CONFIG_ZTEST=y

CONFIG_SERIAL=y
CONFIG_UART_MINDGROVE=y
CONFIG_CONSOLE=y
CONFIG_UART_CONSOLE=y
CONFIG_PRINTK=y
# CONFIG_LOG=y
# CONFIG_LOG_MODE_IMMEDIATE=y

CONFIG_PLIC=y
CONFIG_MULTI_LEVEL_INTERRUPTS=y
CONFIG_2ND_LEVEL_INTERRUPTS=y
CONFIG_NUM_2ND_LEVEL_AGGREGATORS=1
CONFIG_2ND_LVL_INTR_00_OFFSET=11

# This is the one that was missing — tells gen_isr_tables.py
# where the PLIC sources start in the flat ISR table

CONFIG_MAX_IRQ_PER_AGGREGATOR=82
CONFIG_NUM_IRQS=160
CONFIG_INTC_INIT_PRIORITY=40
CONFIG_DYNAMIC_INTERRUPTS=y
CONFIG_GEN_SW_ISR_TABLE=y
CONFIG_GEN_ISR_TABLES=y
```

## src/main.c
```c
/*
 * Copyright (c) 2023 Antmicro
 *
 * SPDX-License-Identifier: Apache-2.0
 */

#include <stdint.h>
#include <zephyr/ztest.h>

uint32_t local_irq_to_reg_index(uint32_t local_irq);
uint32_t local_irq_to_reg_offset(uint32_t local_irq);

ZTEST_SUITE(intc_plic, NULL, NULL, NULL, NULL, NULL);

/* Test calculating the register index from a local IRQ number */
ZTEST(intc_plic, test_local_irq_to_reg_index)
{
	printk("ENTERED TEST 1 \n");
	printk("Expected 0, got %u\n",
       local_irq_to_reg_index(0x1f));

	printk("Expected 1, got %u\n",
	       local_irq_to_reg_index(0x20));
	
	printk("Expected 1, got %u\n",
	       local_irq_to_reg_index(0x3f));
	
	printk("Expected 2, got %u\n",
       local_irq_to_reg_index(0x40));

	// zassert_equal(0, local_irq_to_reg_index(0x1f));
	// zassert_equal(1, local_irq_to_reg_index(0x20));
	// zassert_equal(1, local_irq_to_reg_index(0x3f));
	// zassert_equal(2, local_irq_to_reg_index(0x40));
}

/* Test calculating the register offset from a local IRQ number */
ZTEST(intc_plic, test_local_irq_to_reg_offset)
{
	printk("ENTERED TEST 2 \n");

	printk("Expected 0, got %u\n",
       local_irq_to_reg_offset(0x1f));

	printk("Expected 4, got %u\n",
	       local_irq_to_reg_offset(0x20));

	printk("Expected 4, got %u\n",
	       local_irq_to_reg_offset(0x3f));

	printk("Expected 8, got %u\n",
       local_irq_to_reg_offset(0x40));
	// zassert_equal(0, local_irq_to_reg_offset(0x1f));
	// zassert_equal(4, local_irq_to_reg_offset(0x20));
	// zassert_equal(4, local_irq_to_reg_offset(0x3f));
	// zassert_equal(8, local_irq_to_reg_offset(0x40));
}

// ZTEST(intc_plic, test_hart_context_mapping)
// {
// 	extern const uint32_t plic_hart_contexts_0[];

// 	if (!IS_ENABLED(CONFIG_TEST_INTC_PLIC_ALT_MAPPING)) {
// 		/* Based on the default qemu_riscv64 devicetree */
// 		zassert_equal(plic_hart_contexts_0[0], 0);
// 		zassert_equal(plic_hart_contexts_0[1], 2);
// 		zassert_equal(plic_hart_contexts_0[2], 4);
// 		zassert_equal(plic_hart_contexts_0[3], 6);
// 		zassert_equal(plic_hart_contexts_0[4], 8);
// 		zassert_equal(plic_hart_contexts_0[5], 10);
// 		zassert_equal(plic_hart_contexts_0[6], 12);
// 		zassert_equal(plic_hart_contexts_0[7], 14);
// 	} else {
// 		/* Based on the definition in the `alt_mapping.overlay` */
// 		zassert_equal(plic_hart_contexts_0[0], 0);
// 		zassert_equal(plic_hart_contexts_0[1], 1);
// 		zassert_equal(plic_hart_contexts_0[2], 3);
// 		zassert_equal(plic_hart_contexts_0[3], 5);
// 		zassert_equal(plic_hart_contexts_0[4], 7);
// 		zassert_equal(plic_hart_contexts_0[5], 9);
// 		zassert_equal(plic_hart_contexts_0[6], 11);
// 		zassert_equal(plic_hart_contexts_0[7], 13);
// 	}
// }
```
